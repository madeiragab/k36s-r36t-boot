/ {
    compatible = "rockchip,rk3326-k36s-linux", "rockchip,rk3326";
    interrupt-parent = <0x1>;
    #address-cells = <0x2>;
    #size-cells = <0x2>;
    model = "R36T/K36S";
};
/ddr_timing {
    compatible = "rockchip,ddr-timing";
    ddr2_speed_bin = <0x0>;
    ddr3_speed_bin = <0x15>;
    ddr4_speed_bin = <0xc>;
    pd_idle = <0xd>;
    sr_idle = <0x5d>;
    sr_mc_gate_idle = <0x0>;
    srpd_lite_idle = <0x0>;
    standby_idle = <0x0>;
    auto_pd_dis_freq = <0x42a>;
    auto_sr_dis_freq = <0x320>;
    ddr2_dll_dis_freq = <0x12c>;
    ddr3_dll_dis_freq = <0x12c>;
    ddr4_dll_dis_freq = <0x271>;
    phy_dll_dis_freq = <0x190>;
    ddr2_odt_dis_freq = <0x64>;
    phy_ddr2_odt_dis_freq = <0x64>;
    ddr2_drv = <0x1>;
    ddr2_odt = <0x96>;
    phy_ddr2_ca_drv = <0x15>;
    phy_ddr2_ck_drv = <0x12>;
    phy_ddr2_dq_drv = <0x15>;
    phy_ddr2_odt = <0x2>;
    ddr3_odt_dis_freq = <0x190>;
    phy_ddr3_odt_dis_freq = <0x190>;
    ddr3_drv = <0x28>;
    ddr3_odt = <0x78>;
    phy_ddr3_ca_drv = <0x15>;
    phy_ddr3_ck_drv = <0x12>;
    phy_ddr3_dq_drv = <0x15>;
    phy_ddr3_odt = <0x2>;
    phy_lpddr2_odt_dis_freq = <0x29a>;
    lpddr2_drv = <0x28>;
    phy_lpddr2_ca_drv = <0x16>;
    phy_lpddr2_ck_drv = <0x13>;
    phy_lpddr2_dq_drv = <0x16>;
    phy_lpddr2_odt = <0x0>;
    lpddr3_odt_dis_freq = <0x190>;
    phy_lpddr3_odt_dis_freq = <0x190>;
    lpddr3_drv = <0x28>;
    lpddr3_odt = <0xf0>;
    phy_lpddr3_ca_drv = <0x16>;
    phy_lpddr3_ck_drv = <0x13>;
    phy_lpddr3_dq_drv = <0x16>;
    phy_lpddr3_odt = <0x2>;
    lpddr4_odt_dis_freq = <0x320>;
    phy_lpddr4_odt_dis_freq = <0x320>;
    lpddr4_drv = <0x3c>;
    lpddr4_dq_odt = <0x28>;
    lpddr4_ca_odt = <0x28>;
    phy_lpddr4_ca_drv = <0x14>;
    phy_lpddr4_ck_cs_drv = <0x6>;
    phy_lpddr4_dq_drv = <0x6>;
    phy_lpddr4_odt = <0x10>;
    ddr4_odt_dis_freq = <0x29a>;
    phy_ddr4_odt_dis_freq = <0x29a>;
    ddr4_drv = <0x22>;
    ddr4_odt = <0xf0>;
    phy_ddr4_ca_drv = <0x16>;
    phy_ddr4_ck_drv = <0x13>;
    phy_ddr4_dq_drv = <0x16>;
    phy_ddr4_odt = <0x2>;
    ddr3a1_ddr4a9_de-skew = <0x6>;
    ddr3a0_ddr4a10_de-skew = <0x7>;
    ddr3a3_ddr4a6_de-skew = <0x7>;
    ddr3a2_ddr4a4_de-skew = <0x7>;
    ddr3a5_ddr4a8_de-skew = <0x7>;
    ddr3a4_ddr4a5_de-skew = <0x7>;
    ddr3a7_ddr4a11_de-skew = <0x7>;
    ddr3a6_ddr4a7_de-skew = <0x6>;
    ddr3a9_ddr4a0_de-skew = <0x7>;
    ddr3a8_ddr4a13_de-skew = <0x7>;
    ddr3a11_ddr4a3_de-skew = <0x7>;
    ddr3a10_ddr4cs0_de-skew = <0x7>;
    ddr3a13_ddr4a2_de-skew = <0x7>;
    ddr3a12_ddr4ba1_de-skew = <0x7>;
    ddr3a15_ddr4odt0_de-skew = <0x7>;
    ddr3a14_ddr4a1_de-skew = <0x7>;
    ddr3ba1_ddr4a15_de-skew = <0x7>;
    ddr3ba0_ddr4bg0_de-skew = <0x7>;
    ddr3ras_ddr4cke_de-skew = <0x7>;
    ddr3ba2_ddr4ba0_de-skew = <0x7>;
    ddr3we_ddr4bg1_de-skew = <0x7>;
    ddr3cas_ddr4a12_de-skew = <0x7>;
    ddr3ckn_ddr4ckn_de-skew = <0x7>;
    ddr3ckp_ddr4ckp_de-skew = <0x7>;
    ddr3cke_ddr4a16_de-skew = <0x7>;
    ddr3odt0_ddr4a14_de-skew = <0x7>;
    ddr3cs0_ddr4act_de-skew = <0x6>;
    ddr3reset_ddr4reset_de-skew = <0x7>;
    ddr3cs1_ddr4cs1_de-skew = <0x6>;
    ddr3odt1_ddr4odt1_de-skew = <0x7>;
    cs0_dm0_rx_de-skew = <0x7>;
    cs0_dm0_tx_de-skew = <0x7>;
    cs0_dq0_rx_de-skew = <0x8>;
    cs0_dq0_tx_de-skew = <0x8>;
    cs0_dq1_rx_de-skew = <0x9>;
    cs0_dq1_tx_de-skew = <0x8>;
    cs0_dq2_rx_de-skew = <0x8>;
    cs0_dq2_tx_de-skew = <0x8>;
    cs0_dq3_rx_de-skew = <0x8>;
    cs0_dq3_tx_de-skew = <0x8>;
    cs0_dq4_rx_de-skew = <0x9>;
    cs0_dq4_tx_de-skew = <0x8>;
    cs0_dq5_rx_de-skew = <0x9>;
    cs0_dq5_tx_de-skew = <0x8>;
    cs0_dq6_rx_de-skew = <0x9>;
    cs0_dq6_tx_de-skew = <0x8>;
    cs0_dq7_rx_de-skew = <0x8>;
    cs0_dq7_tx_de-skew = <0x8>;
    cs0_dqs0_rx_de-skew = <0x6>;
    cs0_dqs0p_tx_de-skew = <0x9>;
    cs0_dqs0n_tx_de-skew = <0x9>;
    cs0_dm1_rx_de-skew = <0x7>;
    cs0_dm1_tx_de-skew = <0x6>;
    cs0_dq8_rx_de-skew = <0x8>;
    cs0_dq8_tx_de-skew = <0x7>;
    cs0_dq9_rx_de-skew = <0x9>;
    cs0_dq9_tx_de-skew = <0x7>;
    cs0_dq10_rx_de-skew = <0x8>;
    cs0_dq10_tx_de-skew = <0x8>;
    cs0_dq11_rx_de-skew = <0x8>;
    cs0_dq11_tx_de-skew = <0x7>;
    cs0_dq12_rx_de-skew = <0x8>;
    cs0_dq12_tx_de-skew = <0x8>;
    cs0_dq13_rx_de-skew = <0x9>;
    cs0_dq13_tx_de-skew = <0x7>;
    cs0_dq14_rx_de-skew = <0x9>;
    cs0_dq14_tx_de-skew = <0x8>;
    cs0_dq15_rx_de-skew = <0x9>;
    cs0_dq15_tx_de-skew = <0x7>;
    cs0_dqs1_rx_de-skew = <0x7>;
    cs0_dqs1p_tx_de-skew = <0x9>;
    cs0_dqs1n_tx_de-skew = <0x9>;
    cs0_dm2_rx_de-skew = <0x7>;
    cs0_dm2_tx_de-skew = <0x7>;
    cs0_dq16_rx_de-skew = <0x9>;
    cs0_dq16_tx_de-skew = <0x9>;
    cs0_dq17_rx_de-skew = <0x7>;
    cs0_dq17_tx_de-skew = <0x9>;
    cs0_dq18_rx_de-skew = <0x7>;
    cs0_dq18_tx_de-skew = <0x8>;
    cs0_dq19_rx_de-skew = <0x7>;
    cs0_dq19_tx_de-skew = <0x9>;
    cs0_dq20_rx_de-skew = <0x9>;
    cs0_dq20_tx_de-skew = <0x9>;
    cs0_dq21_rx_de-skew = <0x9>;
    cs0_dq21_tx_de-skew = <0x9>;
    cs0_dq22_rx_de-skew = <0x8>;
    cs0_dq22_tx_de-skew = <0x9>;
    cs0_dq23_rx_de-skew = <0x8>;
    cs0_dq23_tx_de-skew = <0x9>;
    cs0_dqs2_rx_de-skew = <0x6>;
    cs0_dqs2p_tx_de-skew = <0x9>;
    cs0_dqs2n_tx_de-skew = <0x9>;
    cs0_dm3_rx_de-skew = <0x7>;
    cs0_dm3_tx_de-skew = <0x7>;
    cs0_dq24_rx_de-skew = <0x8>;
    cs0_dq24_tx_de-skew = <0x8>;
    cs0_dq25_rx_de-skew = <0x9>;
    cs0_dq25_tx_de-skew = <0x9>;
    cs0_dq26_rx_de-skew = <0x9>;
    cs0_dq26_tx_de-skew = <0x8>;
    cs0_dq27_rx_de-skew = <0x9>;
    cs0_dq27_tx_de-skew = <0x8>;
    cs0_dq28_rx_de-skew = <0x9>;
    cs0_dq28_tx_de-skew = <0x9>;
    cs0_dq29_rx_de-skew = <0x9>;
    cs0_dq29_tx_de-skew = <0x9>;
    cs0_dq30_rx_de-skew = <0x8>;
    cs0_dq30_tx_de-skew = <0x8>;
    cs0_dq31_rx_de-skew = <0x8>;
    cs0_dq31_tx_de-skew = <0x8>;
    cs0_dqs3_rx_de-skew = <0x7>;
    cs0_dqs3p_tx_de-skew = <0x9>;
    cs0_dqs3n_tx_de-skew = <0x9>;
    cs1_dm0_rx_de-skew = <0x7>;
    cs1_dm0_tx_de-skew = <0x7>;
    cs1_dq0_rx_de-skew = <0x8>;
    cs1_dq0_tx_de-skew = <0x8>;
    cs1_dq1_rx_de-skew = <0x9>;
    cs1_dq1_tx_de-skew = <0x8>;
    cs1_dq2_rx_de-skew = <0x8>;
    cs1_dq2_tx_de-skew = <0x8>;
    cs1_dq3_rx_de-skew = <0x8>;
    cs1_dq3_tx_de-skew = <0x8>;
    cs1_dq4_rx_de-skew = <0x8>;
    cs1_dq4_tx_de-skew = <0x8>;
    cs1_dq5_rx_de-skew = <0x9>;
    cs1_dq5_tx_de-skew = <0x8>;
    cs1_dq6_rx_de-skew = <0x9>;
    cs1_dq6_tx_de-skew = <0x8>;
    cs1_dq7_rx_de-skew = <0x8>;
    cs1_dq7_tx_de-skew = <0x8>;
    cs1_dqs0_rx_de-skew = <0x6>;
    cs1_dqs0p_tx_de-skew = <0x9>;
    cs1_dqs0n_tx_de-skew = <0x9>;
    cs1_dm1_rx_de-skew = <0x7>;
    cs1_dm1_tx_de-skew = <0x7>;
    cs1_dq8_rx_de-skew = <0x8>;
    cs1_dq8_tx_de-skew = <0x8>;
    cs1_dq9_rx_de-skew = <0x8>;
    cs1_dq9_tx_de-skew = <0x7>;
    cs1_dq10_rx_de-skew = <0x7>;
    cs1_dq10_tx_de-skew = <0x8>;
    cs1_dq11_rx_de-skew = <0x8>;
    cs1_dq11_tx_de-skew = <0x8>;
    cs1_dq12_rx_de-skew = <0x8>;
    cs1_dq12_tx_de-skew = <0x7>;
    cs1_dq13_rx_de-skew = <0x8>;
    cs1_dq13_tx_de-skew = <0x8>;
    cs1_dq14_rx_de-skew = <0x8>;
    cs1_dq14_tx_de-skew = <0x8>;
    cs1_dq15_rx_de-skew = <0x8>;
    cs1_dq15_tx_de-skew = <0x7>;
    cs1_dqs1_rx_de-skew = <0x7>;
    cs1_dqs1p_tx_de-skew = <0x9>;
    cs1_dqs1n_tx_de-skew = <0x9>;
    cs1_dm2_rx_de-skew = <0x7>;
    cs1_dm2_tx_de-skew = <0x8>;
    cs1_dq16_rx_de-skew = <0x8>;
    cs1_dq16_tx_de-skew = <0x9>;
    cs1_dq17_rx_de-skew = <0x8>;
    cs1_dq17_tx_de-skew = <0x9>;
    cs1_dq18_rx_de-skew = <0x7>;
    cs1_dq18_tx_de-skew = <0x8>;
    cs1_dq19_rx_de-skew = <0x8>;
    cs1_dq19_tx_de-skew = <0x9>;
    cs1_dq20_rx_de-skew = <0x9>;
    cs1_dq20_tx_de-skew = <0x9>;
    cs1_dq21_rx_de-skew = <0x9>;
    cs1_dq21_tx_de-skew = <0x9>;
    cs1_dq22_rx_de-skew = <0x8>;
    cs1_dq22_tx_de-skew = <0x9>;
    cs1_dq23_rx_de-skew = <0x8>;
    cs1_dq23_tx_de-skew = <0x9>;
    cs1_dqs2_rx_de-skew = <0x6>;
    cs1_dqs2p_tx_de-skew = <0x9>;
    cs1_dqs2n_tx_de-skew = <0x9>;
    cs1_dm3_rx_de-skew = <0x7>;
    cs1_dm3_tx_de-skew = <0x7>;
    cs1_dq24_rx_de-skew = <0x8>;
    cs1_dq24_tx_de-skew = <0x9>;
    cs1_dq25_rx_de-skew = <0x9>;
    cs1_dq25_tx_de-skew = <0x9>;
    cs1_dq26_rx_de-skew = <0x9>;
    cs1_dq26_tx_de-skew = <0x8>;
    cs1_dq27_rx_de-skew = <0x8>;
    cs1_dq27_tx_de-skew = <0x8>;
    cs1_dq28_rx_de-skew = <0x9>;
    cs1_dq28_tx_de-skew = <0x9>;
    cs1_dq29_rx_de-skew = <0x9>;
    cs1_dq29_tx_de-skew = <0x9>;
    cs1_dq30_rx_de-skew = <0x9>;
    cs1_dq30_tx_de-skew = <0x8>;
    cs1_dq31_rx_de-skew = <0x8>;
    cs1_dq31_tx_de-skew = <0x8>;
    cs1_dqs3_rx_de-skew = <0x7>;
    cs1_dqs3p_tx_de-skew = <0x9>;
    cs1_dqs3n_tx_de-skew = <0x9>;
    phandle = <0xb3>;
};
/aliases {
    ethernet0 = "/ethernet@ff360000";
    i2c0 = "/i2c@ff180000";
    i2c1 = "/i2c@ff190000";
    i2c2 = "/i2c@ff1a0000";
    i2c3 = "/i2c@ff1b0000";
    serial0 = "/serial@ff030000";
    serial1 = "/serial@ff158000";
    serial2 = "/serial@ff160000";
    serial3 = "/serial@ff168000";
    serial4 = "/serial@ff170000";
    serial5 = "/serial@ff178000";
    spi0 = "/spi@ff1d0000";
    spi1 = "/spi@ff1d8000";
    mmc0 = "/dwmmc@ff370000";
    mmc1 = "/dwmmc@ff380000";
};
/cpus {
    #address-cells = <0x2>;
    #size-cells = <0x0>;
};
/cpus/cpu@0 {
    device_type = "cpu";
    compatible = "arm,cortex-a35", "arm,armv8";
    reg = <0x0 0x0>;
    enable-method = "psci";
    clocks = <0x2 0x7>;
    #cooling-cells = <0x2>;
    dynamic-power-coefficient = <0x5a>;
    operating-points-v2 = <0x3>;
    cpu-idle-states = <0x4 0x5>;
    cpu-supply = <0x6>;
    phandle = <0x9>;
};
/cpus/cpu@1 {
    device_type = "cpu";
    compatible = "arm,cortex-a35", "arm,armv8";
    reg = <0x0 0x1>;
    enable-method = "psci";
    operating-points-v2 = <0x3>;
    cpu-idle-states = <0x4 0x5>;
    phandle = <0xa>;
};
/cpus/cpu@2 {
    device_type = "cpu";
    compatible = "arm,cortex-a35", "arm,armv8";
    reg = <0x0 0x2>;
    enable-method = "psci";
    operating-points-v2 = <0x3>;
    cpu-idle-states = <0x4 0x5>;
    phandle = <0xb>;
};
/cpus/cpu@3 {
    device_type = "cpu";
    compatible = "arm,cortex-a35", "arm,armv8";
    reg = <0x0 0x3>;
    enable-method = "psci";
    operating-points-v2 = <0x3>;
    cpu-idle-states = <0x4 0x5>;
    phandle = <0xc>;
};
/cpus/idle-states {
    entry-method = "psci";
};
/cpus/idle-states/cpu-sleep {
    compatible = "arm,idle-state";
    local-timer-stop;
    arm,psci-suspend-param = <0x10000>;
    entry-latency-us = <0x78>;
    exit-latency-us = <0xfa>;
    min-residency-us = <0x384>;
    phandle = <0x4>;
};
/cpus/idle-states/cluster-sleep {
    compatible = "arm,idle-state";
    local-timer-stop;
    arm,psci-suspend-param = <0x1010000>;
    entry-latency-us = <0x190>;
    exit-latency-us = <0x1f4>;
    min-residency-us = <0x7d0>;
    phandle = <0x5>;
};
/cpu0-opp-table {
    compatible = "operating-points-v2";
    opp-shared;
    rockchip,temp-hysteresis = <0x1388>;
    rockchip,low-temp = <0x0>;
    rockchip,low-temp-min-volt = <0xf4240>;
    rockchip,low-temp-adjust-volt = <0x0 0x5e8 0xc350>;
    clocks = <0x2 0x1>;
    rockchip,avs-scale = <0x4>;
    rockchip,max-volt = <0x149970>;
    rockchip,evb-irdrop = <0x61a8>;
    nvmem-cells = <0x7 0x8>;
    nvmem-cell-names = "cpu_leakage", "performance";
    rockchip,bin-scaling-sel = <0x0 0xd 0x1 0xd>;
    rockchip,pvtm-voltage-sel = <0x0 0xc350 0x0 0xc351 0xd2f0 0x1 0xd2f1 0xea60 0x2 0xea61 0x1869f 0x3>;
    rockchip,pvtm-freq = <0x639c0>;
    rockchip,pvtm-volt = <0xf4240>;
    rockchip,pvtm-ch = <0x0 0x0>;
    rockchip,pvtm-sample-time = <0x3e8>;
    rockchip,pvtm-number = <0xa>;
    rockchip,pvtm-error = <0x3e8>;
    rockchip,pvtm-ref-temp = <0x28>;
    rockchip,pvtm-temp-prop = <0xffffffc8 0xffffffc8>;
    rockchip,thermal-zone = "soc-thermal";
    rockchip,avs = <0x1>;
    phandle = <0x3>;
};
/cpu0-opp-table/opp-1008000000 {
    opp-hz = <0x0 0x3c14dc00>;
    opp-microvolt = <0x11edd8 0x11edd8 0x149970>;
    opp-microvolt-L0 = <0x11edd8 0x11edd8 0x149970>;
    opp-microvolt-L1 = <0x112a88 0x112a88 0x149970>;
    opp-microvolt-L2 = <0x112a88 0x112a88 0x149970>;
    opp-microvolt-L3 = <0x100590 0x100590 0x149970>;
    clock-latency-ns = <0x9c40>;
};
/cpu0-opp-table/opp-1200000000 {
    opp-hz = <0x0 0x47868c00>;
    opp-microvolt = <0x13d620 0x13d620 0x149970>;
    opp-microvolt-L0 = <0x13d620 0x13d620 0x149970>;
    opp-microvolt-L1 = <0x137478 0x137478 0x149970>;
    opp-microvolt-L2 = <0x1312d0 0x1312d0 0x149970>;
    opp-microvolt-L3 = <0x124f80 0x124f80 0x149970>;
    clock-latency-ns = <0x9c40>;
};
/cpu0-opp-table/opp-1248000000 {
    opp-hz = <0x0 0x4a62f800>;
    opp-microvolt = <0x149970 0x149970 0x149970>;
    opp-microvolt-L0 = <0x149970 0x149970 0x149970>;
    opp-microvolt-L1 = <0x13d620 0x13d620 0x149970>;
    opp-microvolt-L2 = <0x137478 0x137478 0x149970>;
    opp-microvolt-L3 = <0x12b128 0x12b128 0x149970>;
    clock-latency-ns = <0x9c40>;
};
/cpu0-opp-table/opp-1296000000 {
    opp-hz = <0x0 0x4d3f6400>;
    opp-microvolt = <0x149970 0x149970 0x149970>;
    opp-microvolt-L0 = <0x149970 0x149970 0x149970>;
    opp-microvolt-L1 = <0x149970 0x149970 0x149970>;
    opp-microvolt-L2 = <0x13d620 0x13d620 0x149970>;
    opp-microvolt-L3 = <0x1312d0 0x1312d0 0x149970>;
    clock-latency-ns = <0x9c40>;
};
/cpu0-opp-table/opp-1416000000 {
    opp-hz = <0x0 0x54667200>;
    opp-microvolt = <0x149970 0x149970 0x149970>;
    opp-microvolt-L0 = <0x149970 0x149970 0x149970>;
    opp-microvolt-L1 = <0x149970 0x149970 0x149970>;
    opp-microvolt-L2 = <0x13d620 0x13d620 0x149970>;
    opp-microvolt-L3 = <0x1312d0 0x1312d0 0x149970>;
    clock-latency-ns = <0x9c40>;
};
/cpu0-opp-table/opp-1512000000 {
    opp-hz = <0x0 0x5a1f4a00>;
    opp-microvolt = <0x149970 0x149970 0x149970>;
    opp-microvolt-L0 = <0x149970 0x149970 0x149970>;
    opp-microvolt-L1 = <0x149970 0x149970 0x149970>;
    opp-microvolt-L2 = <0x13d620 0x13d620 0x149970>;
    opp-microvolt-L3 = <0x1312d0 0x1312d0 0x149970>;
    clock-latency-ns = <0x9c40>;
};
/arm-pmu {
    compatible = "arm,cortex-a53-pmu";
    interrupts = <0x0 0x64 0x4 0x0 0x65 0x4 0x0 0x66 0x4 0x0 0x67 0x4>;
    interrupt-affinity = <0x9 0xa 0xb 0xc>;
};
/bus-soc {
    compatible = "rockchip,px30-bus";
    rockchip,busfreq-policy = "autocs";
    phandle = <0xca>;
};
/bus-soc/soc-bus0 {
    bus-id = <0x0>;
    timer-us = <0x14>;
    enable-msk = <0x40f7>;
    status = "disabled";
};
/bus-soc/soc-bus1 {
    bus-id = <0x1>;
    timer-us = <0xc8>;
    enable-msk = <0x40bf>;
    status = "disabled";
};
/bus-soc/soc-bus2 {
    bus-id = <0x2>;
    timer-us = <0xc8>;
    enable-msk = <0x4007>;
    status = "disabled";
};
/bus-apll {
    compatible = "rockchip,px30-bus";
    rockchip,busfreq-policy = "clkfreq";
    clocks = <0x2 0x1>;
    clock-names = "bus";
    operating-points-v2 = <0xd>;
    status = "okay";
    bus-supply = <0xe>;
    phandle = <0xcb>;
};
/bus-apll-opp-table {
    compatible = "operating-points-v2";
    opp-shared;
    phandle = <0xd>;
};
/bus-apll-opp-table/opp-1512000000 {
    opp-hz = <0x0 0x5a1f4a00>;
    opp-microvolt = <0xf4240>;
};
/bus-apll-opp-table/opp-1008000000 {
    opp-hz = <0x0 0x3c14dc00>;
    opp-microvolt = <0xe7ef0>;
};
/cpuinfo {
    compatible = "rockchip,cpuinfo";
    nvmem-cells = <0xf>;
    nvmem-cell-names = "id";
};
/display-subsystem {
    compatible = "rockchip,display-subsystem";
    ports = <0x10>;
    status = "okay";
    logo-memory-region = <0x11>;
    phandle = <0xcc>;
};
/display-subsystem/route {
};
/display-subsystem/route/route-lvds {
    status = "disabled";
    logo,uboot = "logo.bmp";
    logo,kernel = "logo_kernel.bmp";
    logo,mode = "center";
    charge_logo,mode = "center";
    connect = <0x12>;
    phandle = <0xcd>;
};
/display-subsystem/route/route-dsi {
    status = "okay";
    logo,uboot = "logo.bmp";
    logo,kernel = "logo_kernel.bmp";
    logo,mode = "center";
    charge_logo,mode = "center";
    connect = <0x13>;
    phandle = <0xce>;
};
/display-subsystem/route/route-rgb {
    status = "disabled";
    logo,uboot = "logo.bmp";
    logo,kernel = "logo_kernel.bmp";
    logo,mode = "center";
    charge_logo,mode = "center";
    connect = <0x14>;
    phandle = <0xcf>;
};
/firmware {
};
/firmware/optee {
    compatible = "linaro,optee-tz";
    method = "smc";
};
/external-gmac-clock {
    compatible = "fixed-clock";
    clock-frequency = <0x2faf080>;
    clock-output-names = "gmac_clkin";
    #clock-cells = <0x0>;
    phandle = <0xd0>;
};
/psci {
    compatible = "arm,psci-1.0";
    method = "smc";
};
/rockchip-suspend {
    compatible = "rockchip,pm-px30";
    status = "okay";
    rockchip,sleep-debug-en = <0x1>;
    rockchip,sleep-mode-config = <0x20702>;
    rockchip,wakeup-config = <0x85>;
    phandle = <0xd1>;
};
/timer {
    compatible = "arm,armv8-timer";
    interrupts = <0x1 0xd 0xf04 0x1 0xe 0xf04 0x1 0xb 0xf04 0x1 0xa 0xf04>;
};
/xin24m {
    compatible = "fixed-clock";
    #clock-cells = <0x0>;
    clock-frequency = <0x16e3600>;
    clock-output-names = "xin24m";
    phandle = <0xd2>;
};
/xin32k {
    compatible = "fixed-clock";
    #clock-cells = <0x0>;
    clock-frequency = <0x8000>;
    clock-output-names = "xin32k";
    phandle = <0xd3>;
};
/power-management@ff000000 {
    compatible = "rockchip,px30-pmu", "syscon", "simple-mfd";
    reg = <0x0 0xff000000 0x0 0x1000>;
    phandle = <0xd4>;
};
/power-management@ff000000/power-controller {
    compatible = "rockchip,px30-power-controller";
    #power-domain-cells = <0x1>;
    #address-cells = <0x1>;
    #size-cells = <0x0>;
    phandle = <0x8b>;
};
/power-management@ff000000/power-controller/pd_usb@5 {
    reg = <0x5>;
    clocks = <0x2 0x103 0x2 0x102 0x2 0x3c>;
    pm_qos = <0x15 0x16>;
};
/power-management@ff000000/power-controller/pd_sdcard@7 {
    reg = <0x7>;
    clocks = <0x2 0xf7 0x2 0x3b>;
    pm_qos = <0x17>;
};
/power-management@ff000000/power-controller/pd_gmac@9 {
    reg = <0x9>;
    clocks = <0x2 0xb2 0x2 0x143 0x2 0x40 0x2 0x3f>;
    pm_qos = <0x18>;
};
/power-management@ff000000/power-controller/pd_mmc_nand@10 {
    reg = <0xa>;
    clocks = <0x2 0xfe 0x2 0x100 0x2 0xff 0x2 0x101 0x2 0x39 0x2 0x37 0x2 0x38 0x2 0x3a>;
    pm_qos = <0x19 0x1a 0x1b 0x1c>;
};
/power-management@ff000000/power-controller/pd_vpu@11 {
    reg = <0xb>;
    clocks = <0x2 0xaf 0x2 0xf4 0x2 0x4b>;
    pm_qos = <0x1d 0x1e>;
};
/power-management@ff000000/power-controller/pd_vo@12 {
    reg = <0xc>;
    clocks = <0x2 0xb7 0x2 0xb5 0x2 0xb6 0x2 0x96 0x2 0x97 0x2 0xfd 0x2 0xfb 0x2 0xfc 0x2 0x144 0x2 0x35 0x2 0x36>;
    pm_qos = <0x1f 0x20 0x21 0x22>;
};
/power-management@ff000000/power-controller/pd_vi@13 {
    reg = <0xd>;
    clocks = <0x2 0xb3 0x2 0xb4 0x2 0xf9 0x2 0xfa 0x2 0x33>;
    pm_qos = <0x23 0x24 0x25 0x26 0x27>;
};
/power-management@ff000000/power-controller/pd_gpu@14 {
    reg = <0xe>;
    clocks = <0x2 0x49>;
    pm_qos = <0x28>;
};
/syscon@ff010000 {
    compatible = "rockchip,px30-pmugrf", "syscon", "simple-mfd";
    reg = <0x0 0xff010000 0x0 0x1000>;
    #address-cells = <0x1>;
    #size-cells = <0x1>;
    phandle = <0xb0>;
};
/syscon@ff010000/io-domains {
    compatible = "rockchip,px30-pmu-io-voltage-domain";
    status = "okay";
    pmuio1-supply = <0x29>;
    pmuio2-supply = <0x29>;
    phandle = <0xd5>;
};
/syscon@ff010000/reboot-mode {
    compatible = "syscon-reboot-mode";
    offset = <0x200>;
    mode-bootloader = <0x5242c301>;
    mode-charge = <0x5242c30b>;
    mode-fastboot = <0x5242c309>;
    mode-loader = <0x5242c301>;
    mode-normal = <0x5242c300>;
    mode-recovery = <0x5242c303>;
    mode-ums = <0x5242c30c>;
};
/syscon@ff010000/pmu-pvtm {
    compatible = "rockchip,px30-pmu-pvtm";
    clocks = <0x2a 0x7>;
    clock-names = "pmu";
    status = "okay";
    phandle = <0xd6>;
};
/serial@ff030000 {
    compatible = "rockchip,px30-uart", "snps,dw-apb-uart";
    reg = <0x0 0xff030000 0x0 0x100>;
    interrupts = <0x0 0xf 0x4>;
    clocks = <0x2a 0x6 0x2a 0x15>;
    clock-names = "baudclk", "apb_pclk";
    reg-shift = <0x2>;
    reg-io-width = <0x4>;
    dmas = <0x2b 0x0 0x2b 0x1>;
    pinctrl-names = "default";
    pinctrl-0 = <0x2c 0x2d 0x2e>;
    status = "disabled";
    phandle = <0xd7>;
};
/i2s@ff060000 {
    compatible = "rockchip,px30-i2s-tdm";
    reg = <0x0 0xff060000 0x0 0x1000>;
    interrupts = <0x0 0xc 0x4>;
    clocks = <0x2 0x10 0x2 0x12 0x2 0x106>;
    clock-names = "mclk_tx", "mclk_rx", "hclk";
    dmas = <0x2b 0x10 0x2b 0x11>;
    dma-names = "tx", "rx";
    resets = <0x2 0x84 0x2 0xbf>;
    reset-names = "tx-m", "rx-m";
    rockchip,cru = <0x2>;
    rockchip,grf = <0x2f>;
    pinctrl-names = "default";
    pinctrl-0 = <0x30 0x31 0x32 0x33 0x34 0x35 0x36 0x37 0x38 0x39 0x3a 0x3b>;
    status = "disabled";
    phandle = <0xd8>;
};
/i2s@ff070000 {
    compatible = "rockchip,px30-i2s", "rockchip,rk3066-i2s";
    reg = <0x0 0xff070000 0x0 0x1000>;
    interrupts = <0x0 0xd 0x4>;
    clocks = <0x2 0x14 0x2 0x107>;
    clock-names = "i2s_clk", "i2s_hclk";
    dmas = <0x2b 0x12 0x2b 0x13>;
    dma-names = "tx", "rx";
    resets = <0x2 0x86 0x2 0x85>;
    reset-names = "reset-m", "reset-h";
    pinctrl-names = "default";
    pinctrl-0 = <0x3c 0x3d 0x3e 0x3f>;
    status = "okay";
    #sound-dai-cells = <0x0>;
    phandle = <0xc6>;
};
/i2s@ff080000 {
    compatible = "rockchip,px30-i2s", "rockchip,rk3066-i2s";
    reg = <0x0 0xff080000 0x0 0x1000>;
    interrupts = <0x0 0xe 0x4>;
    clocks = <0x2 0x16 0x2 0x108>;
    clock-names = "i2s_clk", "i2s_hclk";
    dmas = <0x2b 0x14 0x2b 0x15>;
    dma-names = "tx", "rx";
    resets = <0x2 0x88 0x2 0x87>;
    reset-names = "reset-m", "reset-h";
    pinctrl-names = "default";
    pinctrl-0 = <0x40 0x41 0x42 0x43>;
    status = "disabled";
    phandle = <0xd9>;
};
/pdm@ff0a0000 {
    compatible = "rockchip,px30-pdm", "rockchip,pdm";
    reg = <0x0 0xff0a0000 0x0 0x1000>;
    clocks = <0x2 0xf 0x2 0x105>;
    clock-names = "pdm_clk", "pdm_hclk";
    dmas = <0x2b 0x18>;
    dma-names = "rx";
    resets = <0x2 0x82>;
    reset-names = "pdm-m";
    pinctrl-names = "default";
    pinctrl-0 = <0x44 0x45 0x46 0x47 0x48 0x49>;
    status = "disabled";
    phandle = <0xda>;
};
/crypto@ff0b0000 {
    compatible = "rockchip,px30-crypto";
    reg = <0x0 0xff0b0000 0x0 0x4000>;
    interrupts = <0x0 0x52 0x4>;
    clocks = <0x2 0xac 0x2 0xf1 0x2 0x30 0x2 0x31>;
    clock-names = "aclk", "hclk", "sclk", "apb_pclk";
    resets = <0x2 0x74>;
    reset-names = "crypto-rst";
    status = "disabled";
    phandle = <0xdb>;
};
/rng@ff0b0000 {
    compatible = "rockchip,cryptov2-rng";
    reg = <0x0 0xff0b0000 0x0 0x4000>;
    clocks = <0x2 0x30 0x2 0x31 0x2 0xac 0x2 0xf1>;
    clock-names = "clk_crypto", "clk_crypto_apk", "aclk_crypto", "hclk_crypto";
    assigned-clocks = <0x2 0x30 0x2 0x31 0x2 0xac 0x2 0xf1>;
    assigned-clock-rates = <0x8f0d180 0x8f0d180 0xbebc200 0x5f5e100>;
    resets = <0x2 0x74>;
    reset-names = "reset";
    status = "okay";
    phandle = <0xdc>;
};
/interrupt-controller@ff131000 {
    compatible = "arm,gic-400";
    #interrupt-cells = <0x3>;
    #address-cells = <0x0>;
    interrupt-controller;
    reg = <0x0 0xff131000 0x0 0x1000 0x0 0xff132000 0x0 0x2000 0x0 0xff134000 0x0 0x2000 0x0 0xff136000 0x0 0x2000>;
    interrupts = <0x1 0x9 0xf04>;
    phandle = <0x1>;
};
/syscon@ff140000 {
    compatible = "rockchip,px30-grf", "syscon", "simple-mfd";
    reg = <0x0 0xff140000 0x0 0x1000>;
    #address-cells = <0x1>;
    #size-cells = <0x1>;
    phandle = <0x2f>;
};
/syscon@ff140000/io-domains {
    compatible = "rockchip,px30-io-voltage-domain";
    status = "okay";
    vccio1-supply = <0x4a>;
    vccio2-supply = <0x4b>;
    vccio3-supply = <0x4c>;
    vccio4-supply = <0x4d>;
    vccio5-supply = <0x4d>;
    vccio6-supply = <0x4c>;
    phandle = <0xdd>;
};
/syscon@ff140000/lvds {
    compatible = "rockchip,px30-lvds";
    phys = <0x4e>;
    phy-names = "phy";
    status = "disabled";
    phandle = <0xde>;
};
/syscon@ff140000/lvds/ports {
    #address-cells = <0x1>;
    #size-cells = <0x0>;
};
/syscon@ff140000/lvds/ports/port@0 {
    reg = <0x0>;
    #address-cells = <0x1>;
    #size-cells = <0x0>;
};
/syscon@ff140000/lvds/ports/port@0/endpoint@0 {
    reg = <0x0>;
    remote-endpoint = <0x12>;
    phandle = <0xa6>;
};
/syscon@ff140000/rgb {
    compatible = "rockchip,px30-rgb";
    pinctrl-names = "default", "sleep";
    pinctrl-0 = <0x4f>;
    pinctrl-1 = <0x50>;
    status = "disabled";
    phys = <0x4e>;
    phy-names = "phy";
    phandle = <0xdf>;
};
/syscon@ff140000/rgb/ports {
    #address-cells = <0x1>;
    #size-cells = <0x0>;
};
/syscon@ff140000/rgb/ports/port@0 {
    reg = <0x0>;
    #address-cells = <0x1>;
    #size-cells = <0x0>;
};
/syscon@ff140000/rgb/ports/port@0/endpoint@0 {
    reg = <0x0>;
    remote-endpoint = <0x14>;
    phandle = <0xa8>;
};
/syscon@ff148000 {
    compatible = "syscon", "simple-mfd";
    reg = <0x0 0xff148000 0x0 0x1000>;
    #address-cells = <0x1>;
    #size-cells = <0x1>;
    phandle = <0xe0>;
};
/syscon@ff148000/pvtm {
    compatible = "rockchip,px30-pvtm";
    clocks = <0x2 0x4a>;
    clock-names = "core";
    status = "okay";
    phandle = <0xe1>;
};
/serial@ff158000 {
    compatible = "rockchip,px30-uart", "snps,dw-apb-uart";
    reg = <0x0 0xff158000 0x0 0x100>;
    interrupts = <0x0 0x10 0x4>;
    clocks = <0x2 0x18 0x2 0x149>;
    clock-names = "baudclk", "apb_pclk";
    reg-shift = <0x2>;
    reg-io-width = <0x4>;
    dmas = <0x2b 0x2 0x2b 0x3>;
    pinctrl-names = "default";
    pinctrl-0 = <0x51 0x52>;
    status = "okay";
    phandle = <0xe2>;
};
/serial@ff160000 {
    compatible = "rockchip,px30-uart", "snps,dw-apb-uart";
    reg = <0x0 0xff160000 0x0 0x100>;
    interrupts = <0x0 0x11 0x4>;
    clocks = <0x2 0x19 0x2 0x14a>;
    clock-names = "baudclk", "apb_pclk";
    reg-shift = <0x2>;
    reg-io-width = <0x4>;
    dmas = <0x2b 0x4 0x2b 0x5>;
    pinctrl-names = "default";
    pinctrl-0 = <0x53>;
    status = "okay";
    dma-names = "tx";
    phandle = <0xe3>;
};
/serial@ff168000 {
    compatible = "rockchip,px30-uart", "snps,dw-apb-uart";
    reg = <0x0 0xff168000 0x0 0x100>;
    interrupts = <0x0 0x12 0x4>;
    clocks = <0x2 0x1a 0x2 0x14b>;
    clock-names = "baudclk", "apb_pclk";
    reg-shift = <0x2>;
    reg-io-width = <0x4>;
    dmas = <0x2b 0x6 0x2b 0x7>;
    pinctrl-names = "default";
    pinctrl-0 = <0x54 0x55 0x56>;
    status = "disabled";
    phandle = <0xe4>;
};
/serial@ff170000 {
    compatible = "rockchip,px30-uart", "snps,dw-apb-uart";
    reg = <0x0 0xff170000 0x0 0x100>;
    interrupts = <0x0 0x13 0x4>;
    clocks = <0x2 0x1b 0x2 0x14c>;
    clock-names = "baudclk", "apb_pclk";
    reg-shift = <0x2>;
    reg-io-width = <0x4>;
    dmas = <0x2b 0x8 0x2b 0x9>;
    pinctrl-names = "default";
    pinctrl-0 = <0x57 0x58 0x59>;
    status = "disabled";
    phandle = <0xe5>;
};
/serial@ff178000 {
    compatible = "rockchip,px30-uart", "snps,dw-apb-uart";
    reg = <0x0 0xff178000 0x0 0x100>;
    interrupts = <0x0 0x14 0x4>;
    clocks = <0x2 0x1c 0x2 0x14d>;
    clock-names = "baudclk", "apb_pclk";
    reg-shift = <0x2>;
    reg-io-width = <0x4>;
    dmas = <0x2b 0xa 0x2b 0xb>;
    pinctrl-names = "default";
    pinctrl-0 = <0x5a 0x5b 0x5c>;
    status = "disabled";
    clock-frequency = <0x1c200>;
    phandle = <0xe6>;
};
/i2c@ff180000 {
    compatible = "rockchip,rk3399-i2c";
    reg = <0x0 0xff180000 0x0 0x1000>;
    clocks = <0x2 0x1d 0x2 0x14e>;
    clock-names = "i2c", "pclk";
    interrupts = <0x0 0x7 0x4>;
    pinctrl-names = "default";
    pinctrl-0 = <0x5d>;
    #address-cells = <0x1>;
    #size-cells = <0x0>;
    status = "okay";
    clock-frequency = <0x61a80>;
    i2c-scl-rising-time-ns = <0x118>;
    i2c-scl-falling-time-ns = <0x10>;
    phandle = <0xe7>;
};
/i2c@ff180000/pmic@20 {
    compatible = "rockchip,rk817";
    reg = <0x20>;
    interrupt-parent = <0x5e>;
    interrupts = <0xa 0x8>;
    pinctrl-names = "default", "pmic-sleep", "pmic-power-off", "pmic-reset";
    pinctrl-0 = <0x5f>;
    pinctrl-1 = <0x60 0x61>;
    pinctrl-2 = <0x62 0x63>;
    pinctrl-3 = <0x64 0x65>;
    rockchip,system-power-controller;
    wakeup-source;
    #clock-cells = <0x1>;
    clock-output-names = "rk808-clkout1", "rk808-clkout2";
    pmic-reset-func = <0x1>;
    vcc1-supply = <0x66>;
    vcc2-supply = <0x66>;
    vcc3-supply = <0x66>;
    vcc4-supply = <0x66>;
    vcc5-supply = <0x66>;
    vcc6-supply = <0x66>;
    vcc7-supply = <0x4d>;
    vcc8-supply = <0x66>;
    vcc9-supply = <0x67>;
    phandle = <0xe8>;
};
/i2c@ff180000/pmic@20/pwrkey {
    status = "okay";
};
/i2c@ff180000/pmic@20/pinctrl_rk8xx {
    gpio-controller;
    #gpio-cells = <0x2>;
    phandle = <0xe9>;
};
/i2c@ff180000/pmic@20/pinctrl_rk8xx/rk817_ts_gpio1 {
    pins = "gpio_ts";
    function = "pin_fun1";
    phandle = <0xea>;
};
/i2c@ff180000/pmic@20/pinctrl_rk8xx/rk817_gt_gpio2 {
    pins = "gpio_gt";
    function = "pin_fun1";
    phandle = <0xeb>;
};
/i2c@ff180000/pmic@20/pinctrl_rk8xx/rk817_pin_ts {
    pins = "gpio_ts";
    function = "pin_fun0";
    phandle = <0xec>;
};
/i2c@ff180000/pmic@20/pinctrl_rk8xx/rk817_pin_gt {
    pins = "gpio_gt";
    function = "pin_fun0";
    phandle = <0xed>;
};
/i2c@ff180000/pmic@20/pinctrl_rk8xx/rk817_slppin_null {
    pins = "gpio_slp";
    function = "pin_fun0";
    phandle = <0xee>;
};
/i2c@ff180000/pmic@20/pinctrl_rk8xx/rk817_slppin_slp {
    pins = "gpio_slp";
    function = "pin_fun1";
    phandle = <0x61>;
};
/i2c@ff180000/pmic@20/pinctrl_rk8xx/rk817_slppin_pwrdn {
    pins = "gpio_slp";
    function = "pin_fun2";
    phandle = <0x63>;
};
/i2c@ff180000/pmic@20/pinctrl_rk8xx/rk817_slppin_rst {
    pins = "gpio_slp";
    function = "pin_fun3";
    phandle = <0x65>;
};
/i2c@ff180000/pmic@20/regulators {
};
/i2c@ff180000/pmic@20/regulators/DCDC_REG1 {
    regulator-always-on;
    regulator-boot-on;
    regulator-min-microvolt = <0xe7ef0>;
    regulator-max-microvolt = <0x118c30>;
    regulator-ramp-delay = <0x1771>;
    regulator-initial-mode = <0x2>;
    regulator-name = "vdd_logic";
    phandle = <0xe>;
};
/i2c@ff180000/pmic@20/regulators/DCDC_REG1/regulator-state-mem {
    regulator-on-in-suspend;
    regulator-suspend-microvolt = <0xe7ef0>;
};
/i2c@ff180000/pmic@20/regulators/DCDC_REG2 {
    regulator-always-on;
    regulator-boot-on;
    regulator-min-microvolt = <0xe7ef0>;
    regulator-max-microvolt = <0x149970>;
    regulator-ramp-delay = <0x1771>;
    regulator-initial-mode = <0x2>;
    regulator-name = "vdd_arm";
    phandle = <0x6>;
};
/i2c@ff180000/pmic@20/regulators/DCDC_REG2/regulator-state-mem {
    regulator-off-in-suspend;
    regulator-suspend-microvolt = <0xe7ef0>;
};
/i2c@ff180000/pmic@20/regulators/DCDC_REG3 {
    regulator-always-on;
    regulator-boot-on;
    regulator-initial-mode = <0x2>;
    regulator-name = "vcc_ddr";
    phandle = <0xef>;
};
/i2c@ff180000/pmic@20/regulators/DCDC_REG3/regulator-state-mem {
    regulator-on-in-suspend;
};
/i2c@ff180000/pmic@20/regulators/DCDC_REG4 {
    regulator-always-on;
    regulator-boot-on;
    regulator-min-microvolt = <0x2dc6c0>;
    regulator-max-microvolt = <0x2dc6c0>;
    regulator-initial-mode = <0x2>;
    regulator-name = "vcc_3v0";
    phandle = <0x4d>;
};
/i2c@ff180000/pmic@20/regulators/DCDC_REG4/regulator-state-mem {
    regulator-off-in-suspend;
    regulator-suspend-microvolt = <0x2dc6c0>;
};
/i2c@ff180000/pmic@20/regulators/DCDC_REG5 {
    regulator-always-on;
    regulator-boot-on;
    regulator-min-microvolt = <0x325aa0>;
    regulator-max-microvolt = <0x325aa0>;
    regulator-name = "vcc3v3_sys";
    phandle = <0xf0>;
};
/i2c@ff180000/pmic@20/regulators/DCDC_REG5/regulator-state-mem {
    regulator-on-in-suspend;
    regulator-suspend-microvolt = <0x325aa0>;
};
/i2c@ff180000/pmic@20/regulators/LDO_REG1 {
    regulator-always-on;
    regulator-boot-on;
    regulator-min-microvolt = <0xf4240>;
    regulator-max-microvolt = <0xf4240>;
    regulator-name = "vcc_1v0";
    phandle = <0xf1>;
};
/i2c@ff180000/pmic@20/regulators/LDO_REG1/regulator-state-mem {
    regulator-on-in-suspend;
    regulator-suspend-microvolt = <0xf4240>;
};
/i2c@ff180000/pmic@20/regulators/LDO_REG2 {
    regulator-always-on;
    regulator-boot-on;
    regulator-min-microvolt = <0x1b7740>;
    regulator-max-microvolt = <0x1b7740>;
    regulator-name = "vcc1v8_soc";
    phandle = <0x4c>;
};
/i2c@ff180000/pmic@20/regulators/LDO_REG2/regulator-state-mem {
    regulator-on-in-suspend;
    regulator-suspend-microvolt = <0x1b7740>;
};
/i2c@ff180000/pmic@20/regulators/LDO_REG3 {
    regulator-always-on;
    regulator-boot-on;
    regulator-min-microvolt = <0xf4240>;
    regulator-max-microvolt = <0xf4240>;
    regulator-name = "vcc1v0_soc";
    phandle = <0xf2>;
};
/i2c@ff180000/pmic@20/regulators/LDO_REG3/regulator-state-mem {
    regulator-on-in-suspend;
    regulator-suspend-microvolt = <0xf4240>;
};
/i2c@ff180000/pmic@20/regulators/LDO_REG4 {
    regulator-always-on;
    regulator-boot-on;
    regulator-min-microvolt = <0x2dc6c0>;
    regulator-max-microvolt = <0x2dc6c0>;
    regulator-name = "vcc3v0_pmu";
    phandle = <0x29>;
};
/i2c@ff180000/pmic@20/regulators/LDO_REG4/regulator-state-mem {
    regulator-on-in-suspend;
    regulator-suspend-microvolt = <0x2dc6c0>;
};
/i2c@ff180000/pmic@20/regulators/LDO_REG5 {
    regulator-always-on;
    regulator-boot-on;
    regulator-min-microvolt = <0x1b7740>;
    regulator-max-microvolt = <0x1b7740>;
    regulator-name = "vccio_sd";
    phandle = <0x4b>;
};
/i2c@ff180000/pmic@20/regulators/LDO_REG5/regulator-state-mem {
    regulator-on-in-suspend;
    regulator-suspend-microvolt = <0x1b7740>;
};
/i2c@ff180000/pmic@20/regulators/LDO_REG6 {
    regulator-min-microvolt = <0x1b7740>;
    regulator-max-microvolt = <0x2dc6c0>;
    regulator-always-on;
    regulator-boot-on;
    regulator-name = "vcc_sd";
    phandle = <0x94>;
};
/i2c@ff180000/pmic@20/regulators/LDO_REG6/regulator-state-mem {
    regulator-on-in-suspend;
    regulator-suspend-microvolt = <0x2dc6c0>;
};
/i2c@ff180000/pmic@20/regulators/LDO_REG7 {
    regulator-always-on;
    regulator-boot-on;
    regulator-min-microvolt = <0x1b7740>;
    regulator-max-microvolt = <0x325aa0>;
    regulator-init-microvolt = <0x2dc6c0>;
    regulator-name = "vcc_backlight";
    phandle = <0x4a>;
};
/i2c@ff180000/pmic@20/regulators/LDO_REG7/regulator-state-mem {
    regulator-on-in-suspend;
    regulator-suspend-microvolt = <0x2dc6c0>;
};
/i2c@ff180000/pmic@20/regulators/LDO_REG8 {
    regulator-always-on;
    regulator-boot-on;
    regulator-min-microvolt = <0x325aa0>;
    regulator-max-microvolt = <0x325aa0>;
    regulator-name = "vcc3v0_dvp";
    phandle = <0xf3>;
};
/i2c@ff180000/pmic@20/regulators/LDO_REG8/regulator-state-mem {
    regulator-on-in-suspend;
    regulator-suspend-microvolt = <0x325aa0>;
};
/i2c@ff180000/pmic@20/regulators/LDO_REG9 {
    regulator-always-on;
    regulator-boot-on;
    regulator-min-microvolt = <0x16e360>;
    regulator-max-microvolt = <0x16e360>;
    regulator-name = "vdd1v5_dvp";
    phandle = <0xf4>;
};
/i2c@ff180000/pmic@20/regulators/LDO_REG9/regulator-state-mem {
    regulator-off-in-suspend;
    regulator-suspend-microvolt = <0x16e360>;
};
/i2c@ff180000/pmic@20/regulators/SWITCH_REG1 {
    regulator-always-on;
    regulator-boot-on;
    regulator-name = "vcc5v0_host";
    phandle = <0xff>;
};
/i2c@ff180000/pmic@20/regulators/SWITCH_REG2 {
    regulator-always-on;
    regulator-boot-on;
    regulator-name = "vcc3v3_lcd";
    phandle = <0x100>;
};
/i2c@ff180000/pmic@20/regulators/BOOST {
    regulator-always-on;
    regulator-boot-on;
    regulator-min-microvolt = <0x4c4b40>;
    regulator-max-microvolt = <0x5265c0>;
    regulator-name = "boost";
    phandle = <0x67>;
};
/i2c@ff180000/pmic@20/regulators/OTG_SWITCH {
    regulator-boot-on;
    regulator-name = "otg_switch";
    phandle = <0xf5>;
};
/i2c@ff180000/pmic@20/battery {
    compatible = "rk817,battery-5.10";
    ocv_table = <0xce4 0xd0c 0xd34 0xd5c 0xd84 0xdac 0xdd4 0xdf2 0xe1a 0xe42 0xe6a 0xe88 0xea6 0xece 0xef6 0xf1e 0xf46 0xf64 0xf7f 0xfa1 0xfce>;
    design_capacity = <0xad7>;
    design_qmax = <0xbec>;
    bat_res = <0x65>;
    sleep_enter_current = <0x12c>;
    sleep_exit_current = <0x12c>;
    sleep_filter_current = <0x64>;
    power_off_thresd = <0xdac>;
    zero_algorithm_vol = <0xf0a>;
    max_soc_offset = <0x3c>;
    monitor_sec = <0x5>;
    sample_res = <0xa>;
    virtual_power = <0x0>;
    power_dc2otg = <0x0>;
    bat-low-threshold = <0x1e>;
    bat_low_gpio = <0x5e 0x11 0x0>;
};
/i2c@ff180000/pmic@20/charger {
    compatible = "rk817,charger";
    min_input_voltage = <0x1194>;
    max_input_current = <0x320>;
    max_chrg_current = <0x320>;
    max_chrg_voltage = <0x1068>;
    chrg_term_mode = <0x0>;
    chrg_finish_cur = <0x12c>;
    virtual_power = <0x0>;
    sample_res = <0xa>;
    dc_det_gpio = <0x68 0x5 0x0>;
    extcon = <0x69>;
};
/i2c@ff180000/pmic@20/codec {
    #sound-dai-cells = <0x0>;
    compatible = "rockchip,rk817-codec";
    clocks = <0x2 0x15>;
    clock-names = "mclk";
    pinctrl-names = "default";
    pinctrl-0 = <0x6a>;
    hp-volume = <0x14>;
    spk-volume = <0x3>;
    status = "okay";
    phandle = <0xc7>;
};
/i2c@ff190000 {
    compatible = "rockchip,rk3399-i2c";
    reg = <0x0 0xff190000 0x0 0x1000>;
    clocks = <0x2 0x1e 0x2 0x14f>;
    clock-names = "i2c", "pclk";
    interrupts = <0x0 0x8 0x4>;
    pinctrl-names = "default";
    pinctrl-0 = <0x6b>;
    #address-cells = <0x1>;
    #size-cells = <0x0>;
    status = "okay";
    clock-frequency = <0x61a80>;
    phandle = <0xf6>;
};
/i2c@ff1a0000 {
    compatible = "rockchip,rk3399-i2c";
    reg = <0x0 0xff1a0000 0x0 0x1000>;
    clocks = <0x2 0x1f 0x2 0x150>;
    clock-names = "i2c", "pclk";
    interrupts = <0x0 0x9 0x4>;
    pinctrl-names = "default";
    pinctrl-0 = <0x6c>;
    #address-cells = <0x1>;
    #size-cells = <0x0>;
    status = "disabled";
    phandle = <0xf7>;
};
/i2c@ff1b0000 {
    compatible = "rockchip,rk3399-i2c";
    reg = <0x0 0xff1b0000 0x0 0x1000>;
    clocks = <0x2 0x20 0x2 0x151>;
    clock-names = "i2c", "pclk";
    interrupts = <0x0 0xa 0x4>;
    pinctrl-names = "default";
    pinctrl-0 = <0x6d>;
    #address-cells = <0x1>;
    #size-cells = <0x0>;
    status = "disabled";
    phandle = <0xf8>;
};
/spi@ff1d0000 {
    compatible = "rockchip,px30-spi", "rockchip,rk3066-spi";
    reg = <0x0 0xff1d0000 0x0 0x1000>;
    interrupts = <0x0 0x1a 0x4>;
    #address-cells = <0x1>;
    #size-cells = <0x0>;
    clocks = <0x2 0x24 0x2 0x155>;
    clock-names = "spiclk", "apb_pclk";
    dmas = <0x2b 0xc 0x2b 0xd>;
    dma-names = "tx", "rx";
    pinctrl-names = "default", "high_speed";
    pinctrl-0 = <0x6e 0x6f 0x70 0x71>;
    pinctrl-1 = <0x72 0x6f 0x73 0x74>;
    status = "disabled";
    phandle = <0xf9>;
};
/spi@ff1d8000 {
    compatible = "rockchip,px30-spi", "rockchip,rk3066-spi";
    reg = <0x0 0xff1d8000 0x0 0x1000>;
    interrupts = <0x0 0x1b 0x4>;
    #address-cells = <0x1>;
    #size-cells = <0x0>;
    clocks = <0x2 0x25 0x2 0x156>;
    clock-names = "spiclk", "apb_pclk";
    dmas = <0x2b 0xe 0x2b 0xf>;
    dma-names = "tx", "rx";
    pinctrl-names = "default", "high_speed";
    pinctrl-0 = <0x75 0x76 0x77 0x78 0x79>;
    pinctrl-1 = <0x7a 0x76 0x77 0x7b 0x7c>;
    status = "disabled";
    phandle = <0xfa>;
};
/watchdog@ff1e0000 {
    compatible = "snps,dw-wdt";
    reg = <0x0 0xff1e0000 0x0 0x100>;
    clocks = <0x2 0x15b>;
    interrupts = <0x0 0x25 0x4>;
    resets = <0x2 0xb5>;
    reset-names = "reset";
    status = "disabled";
    phandle = <0xfb>;
};
/pwm@ff200000 {
    compatible = "rockchip,px30-pwm", "rockchip,rk3328-pwm";
    reg = <0x0 0xff200000 0x0 0x10>;
    #pwm-cells = <0x3>;
    pinctrl-names = "active";
    pinctrl-0 = <0x7d>;
    clocks = <0x2 0x22 0x2 0x153>;
    clock-names = "pwm", "pclk";
    status = "okay";
    phandle = <0xc1>;
};
/pwm@ff200010 {
    compatible = "rockchip,px30-pwm", "rockchip,rk3328-pwm";
    reg = <0x0 0xff200010 0x0 0x10>;
    #pwm-cells = <0x3>;
    pinctrl-names = "active";
    pinctrl-0 = <0x7e>;
    clocks = <0x2 0x22 0x2 0x153>;
    clock-names = "pwm", "pclk";
    status = "okay";
    phandle = <0xc4>;
};
/pwm@ff200020 {
    compatible = "rockchip,px30-pwm", "rockchip,rk3328-pwm";
    reg = <0x0 0xff200020 0x0 0x10>;
    #pwm-cells = <0x3>;
    pinctrl-names = "active";
    pinctrl-0 = <0x7f>;
    clocks = <0x2 0x22 0x2 0x153>;
    clock-names = "pwm", "pclk";
    status = "disabled";
    phandle = <0xfc>;
};
/pwm@ff200030 {
    compatible = "rockchip,px30-pwm", "rockchip,rk3328-pwm";
    reg = <0x0 0xff200030 0x0 0x10>;
    #pwm-cells = <0x3>;
    pinctrl-names = "active";
    pinctrl-0 = <0x80>;
    clocks = <0x2 0x22 0x2 0x153>;
    clock-names = "pwm", "pclk";
    status = "disabled";
    phandle = <0xfd>;
};
/pwm@ff208000 {
    compatible = "rockchip,px30-pwm", "rockchip,rk3328-pwm";
    reg = <0x0 0xff208000 0x0 0x10>;
    #pwm-cells = <0x3>;
    pinctrl-names = "active";
    pinctrl-0 = <0x81>;
    clocks = <0x2 0x23 0x2 0x154>;
    clock-names = "pwm", "pclk";
    status = "disabled";
    phandle = <0xfe>;
};
/pwm@ff208010 {
    compatible = "rockchip,px30-pwm", "rockchip,rk3328-pwm";
    reg = <0x0 0xff208010 0x0 0x10>;
    #pwm-cells = <0x3>;
    pinctrl-names = "active";
    pinctrl-0 = <0x82>;
    clocks = <0x2 0x23 0x2 0x154>;
    clock-names = "pwm", "pclk";
    status = "disabled";
    phandle = <0x101>;
};
/pwm@ff208020 {
    compatible = "rockchip,px30-pwm", "rockchip,rk3328-pwm";
    reg = <0x0 0xff208020 0x0 0x10>;
    #pwm-cells = <0x3>;
    pinctrl-names = "active";
    pinctrl-0 = <0x83>;
    clocks = <0x2 0x23 0x2 0x154>;
    clock-names = "pwm", "pclk";
    status = "disabled";
    phandle = <0x102>;
};
/pwm@ff208030 {
    compatible = "rockchip,px30-pwm", "rockchip,rk3328-pwm";
    reg = <0x0 0xff208030 0x0 0x10>;
    #pwm-cells = <0x3>;
    pinctrl-names = "active";
    pinctrl-0 = <0x84>;
    clocks = <0x2 0x23 0x2 0x154>;
    clock-names = "pwm", "pclk";
    status = "disabled";
    phandle = <0x103>;
};
/rktimer@ff210000 {
    compatible = "rockchip,rk3288-timer";
    reg = <0x0 0xff210000 0x0 0x1000>;
    interrupts = <0x0 0x1e 0x4>;
    clocks = <0x2 0x159 0x2 0x26>;
    clock-names = "pclk", "timer";
    phandle = <0x104>;
};
/amba {
    compatible = "simple-bus";
    #address-cells = <0x2>;
    #size-cells = <0x2>;
    ranges;
};
/amba/dmac@ff240000 {
    compatible = "arm,pl330", "arm,primecell";
    reg = <0x0 0xff240000 0x0 0x4000>;
    interrupts = <0x0 0x1 0x4 0x0 0x2 0x4>;
    clocks = <0x2 0xbb>;
    clock-names = "apb_pclk";
    #dma-cells = <0x1>;
    peripherals-req-type-burst;
    phandle = <0x2b>;
};
/thermal-zones {
    phandle = <0x105>;
};
/thermal-zones/soc-thermal {
    polling-delay-passive = <0x14>;
    polling-delay = <0x3e8>;
    sustainable-power = <0x2ee>;
    thermal-sensors = <0x85 0x0>;
    phandle = <0x106>;
};
/thermal-zones/soc-thermal/trips {
};
/thermal-zones/soc-thermal/trips/trip-point-0 {
    temperature = <0x11170>;
    hysteresis = <0x7d0>;
    type = "passive";
    phandle = <0x107>;
};
/thermal-zones/soc-thermal/trips/trip-point-1 {
    temperature = <0x14c08>;
    hysteresis = <0x7d0>;
    type = "passive";
    phandle = <0x86>;
};
/thermal-zones/soc-thermal/trips/soc-crit {
    temperature = <0x1c138>;
    hysteresis = <0x7d0>;
    type = "critical";
    phandle = <0x108>;
};
/thermal-zones/soc-thermal/cooling-maps {
};
/thermal-zones/soc-thermal/cooling-maps/map0 {
    trip = <0x86>;
    cooling-device = <0x9 0xffffffff 0xffffffff>;
    contribution = <0x1000>;
};
/thermal-zones/soc-thermal/cooling-maps/map1 {
    trip = <0x86>;
    cooling-device = <0x87 0xffffffff 0xffffffff>;
    contribution = <0x1000>;
};
/thermal-zones/gpu-thermal {
    polling-delay-passive = <0x64>;
    polling-delay = <0x3e8>;
    thermal-sensors = <0x85 0x1>;
    phandle = <0x109>;
};
/tsadc@ff280000 {
    compatible = "rockchip,px30-tsadc";
    reg = <0x0 0xff280000 0x0 0x100>;
    interrupts = <0x0 0x24 0x4>;
    rockchip,grf = <0x2f>;
    clocks = <0x2 0x2c 0x2 0x158>;
    clock-names = "tsadc", "apb_pclk";
    assigned-clocks = <0x2 0x2c>;
    assigned-clock-rates = <0xc350>;
    resets = <0x2 0xa8>;
    reset-names = "tsadc-apb";
    #thermal-sensor-cells = <0x1>;
    rockchip,hw-tshut-temp = <0x1d4c0>;
    status = "okay";
    pinctrl-names = "gpio", "otpout";
    pinctrl-0 = <0x88>;
    pinctrl-1 = <0x89>;
    pinctrl-2 = <0x88>;
    phandle = <0x85>;
};
/saradc@ff288000 {
    compatible = "rockchip,px30-saradc", "rockchip,rk3399-saradc";
    reg = <0x0 0xff288000 0x0 0x100>;
    interrupts = <0x0 0x54 0x4>;
    #io-channel-cells = <0x1>;
    clocks = <0x2 0x2d 0x2 0x157>;
    clock-names = "saradc", "apb_pclk";
    resets = <0x2 0xa5>;
    reset-names = "saradc-apb";
    status = "okay";
    vref-supply = <0x4c>;
    phandle = <0xc0>;
};
/otp@ff290000 {
    compatible = "rockchip,px30-otp";
    reg = <0x0 0xff290000 0x0 0x4000>;
    #address-cells = <0x1>;
    #size-cells = <0x1>;
    clocks = <0x2 0x2f 0x2 0x15a 0x2 0x161>;
    clock-names = "clk_otp", "pclk_otp", "pclk_otp_phy";
    resets = <0x2 0xb4>;
    reset-names = "otp_phy";
    phandle = <0x10a>;
};
/otp@ff290000/id@7 {
    reg = <0x7 0x10>;
    phandle = <0xf>;
};
/otp@ff290000/cpu-leakage@17 {
    reg = <0x17 0x1>;
    phandle = <0x7>;
};
/otp@ff290000/performance@1e {
    reg = <0x1e 0x1>;
    bits = <0x4 0x3>;
    phandle = <0x8>;
};
/clock-controller@ff2b0000 {
    compatible = "rockchip,px30-cru";
    reg = <0x0 0xff2b0000 0x0 0x1000>;
    rockchip,grf = <0x2f>;
    rockchip,boost = <0x8a>;
    #clock-cells = <0x1>;
    #reset-cells = <0x1>;
    assigned-clocks = <0x2 0x4>;
    assigned-clock-rates = <0x3dfd2400>;
    phandle = <0x2>;
};
/cpu-boost@ff2b8000 {
    compatible = "syscon";
    reg = <0x0 0xff2b8000 0x0 0x1000>;
    rockchip,boost-low-con0 = <0x1032>;
    rockchip,boost-low-con1 = <0x1441>;
    rockchip,boost-high-con0 = <0x1036>;
    rockchip,boost-high-con1 = <0x1441>;
    rockchip,boost-backup-pll = <0x1>;
    rockchip,boost-backup-pll-usage = <0x0>;
    rockchip,boost-switch-threshold = <0x249f00>;
    rockchip,boost-statis-threshold = <0x100>;
    rockchip,boost-statis-enable = <0x0>;
    rockchip,boost-enable = <0x0>;
    phandle = <0x8a>;
};
/pmu-clock-controller@ff2bc000 {
    compatible = "rockchip,px30-pmucru";
    reg = <0x0 0xff2bc000 0x0 0x1000>;
    rockchip,grf = <0x2f>;
    #clock-cells = <0x1>;
    #reset-cells = <0x1>;
    assigned-clocks = <0x2a 0x1 0x2a 0x8 0x2a 0x5 0x2 0x7 0x2 0xab 0x2 0xb0 0x2 0xf0 0x2 0xf5 0x2 0x140 0x2 0x49>;
    assigned-clock-rates = <0x47868c00 0x5f5e100 0x18cba80 0x23c34600 0xbebc200 0xbebc200 0x8f0d180 0x8f0d180 0x5f5e100 0xbebc200>;
    phandle = <0x2a>;
};
/syscon@ff2c0000 {
    compatible = "rockchip,px30-usb2phy-grf", "syscon", "simple-mfd";
    reg = <0x0 0xff2c0000 0x0 0x10000>;
    #address-cells = <0x1>;
    #size-cells = <0x1>;
    phandle = <0x10b>;
};
/syscon@ff2c0000/usb2-phy@100 {
    compatible = "rockchip,px30-usb2phy", "rockchip,rk3328-usb2phy";
    reg = <0x100 0x10>;
    clocks = <0x2a 0xa>;
    clock-names = "phyclk";
    #clock-cells = <0x0>;
    assigned-clocks = <0x2 0xe 0x2 0x55>;
    assigned-clock-parents = <0x69 0x2 0xe>;
    clock-output-names = "usb480m_phy";
    status = "okay";
    phandle = <0x69>;
};
/syscon@ff2c0000/usb2-phy@100/host-port {
    #phy-cells = <0x0>;
    interrupts = <0x0 0x44 0x4>;
    interrupt-names = "linestate";
    status = "okay";
    phandle = <0x8d>;
};
/syscon@ff2c0000/usb2-phy@100/otg-port {
    #phy-cells = <0x0>;
    interrupts = <0x0 0x42 0x4 0x0 0x41 0x4 0x0 0x40 0x4>;
    interrupt-names = "otg-bvalid", "otg-id", "linestate";
    status = "disabled";
    phandle = <0x8c>;
};
/video-phy@ff2e0000 {
    compatible = "rockchip,px30-video-phy";
    reg = <0x0 0xff2e0000 0x0 0x10000 0x0 0xff450000 0x0 0x10000>;
    clocks = <0x2a 0xb 0x2 0x145 0x2 0x144>;
    clock-names = "ref", "pclk_phy", "pclk_host";
    #clock-cells = <0x0>;
    resets = <0x2 0x3e>;
    reset-names = "rst";
    power-domains = <0x8b 0xc>;
    #phy-cells = <0x0>;
    status = "okay";
    phandle = <0x4e>;
};
/mipi-dphy-rx0@ff2f0000 {
    compatible = "rockchip,rk3326-mipi-dphy";
    reg = <0x0 0xff2f0000 0x0 0x4000>;
    clocks = <0x2 0x146>;
    clock-names = "dphy-ref";
    power-domains = <0x8b 0xd>;
    rockchip,grf = <0x2f>;
    status = "okay";
    phandle = <0x10c>;
};
/usb@ff300000 {
    compatible = "rockchip,px30-usb", "rockchip,rk3066-usb", "snps,dwc2";
    reg = <0x0 0xff300000 0x0 0x40000>;
    interrupts = <0x0 0x3e 0x4>;
    clocks = <0x2 0x102>;
    clock-names = "otg";
    power-domains = <0x8b 0x5>;
    dr_mode = "otg";
    g-np-tx-fifo-size = <0x10>;
    g-rx-fifo-size = <0x118>;
    g-tx-fifo-size = <0x100 0x80 0x80 0x40 0x20 0x10>;
    g-use-dma;
    phys = <0x8c>;
    phy-names = "usb2-phy";
    status = "okay";
    phandle = <0x10d>;
};
/usb@ff340000 {
    compatible = "generic-ehci";
    reg = <0x0 0xff340000 0x0 0x10000>;
    interrupts = <0x0 0x3c 0x4>;
    clocks = <0x2 0x103 0x69>;
    clock-names = "usbhost", "utmi";
    power-domains = <0x8b 0x5>;
    phys = <0x8d>;
    phy-names = "usb";
    status = "disabled";
    phandle = <0x10e>;
};
/usb@ff350000 {
    compatible = "generic-ohci";
    reg = <0x0 0xff350000 0x0 0x10000>;
    interrupts = <0x0 0x3d 0x4>;
    clocks = <0x2 0x103 0x69>;
    clock-names = "usbhost", "utmi";
    power-domains = <0x8b 0x5>;
    phys = <0x8d>;
    phy-names = "usb";
    status = "disabled";
    phandle = <0x10f>;
};
/ethernet@ff360000 {
    compatible = "rockchip,px30-gmac";
    reg = <0x0 0xff360000 0x0 0x10000>;
    rockchip,grf = <0x2f>;
    interrupts = <0x0 0x2b 0x4>;
    interrupt-names = "macirq";
    clocks = <0x2 0x3e 0x2 0x3f 0x2 0x3f 0x2 0x40 0x2 0x41 0x2 0xb2 0x2 0x143 0x2 0x4c>;
    clock-names = "stmmaceth", "mac_clk_rx", "mac_clk_tx", "clk_mac_ref", "clk_mac_refout", "aclk_mac", "pclk_mac", "clk_mac_speed";
    phy-mode = "rmii";
    pinctrl-names = "default";
    pinctrl-0 = <0x8e 0x8f>;
    resets = <0x2 0x5e>;
    reset-names = "stmmaceth";
    power-domains = <0x8b 0x9>;
    status = "disabled";
    phandle = <0x110>;
};
/dwmmc@ff370000 {
    compatible = "rockchip,px30-dw-mshc", "rockchip,rk3288-dw-mshc";
    reg = <0x0 0xff370000 0x0 0x4000>;
    no-sd-uhs-sdr104;
    no-sd-uhs-sdr25;
    no-mmc-hs200;
    max-frequency = <0x8f0d180>;
    clocks = <0x2 0xf7 0x2 0x3b 0x2 0x43 0x2 0x44>;
    clock-names = "biu", "ciu", "ciu-drv", "ciu-sample";
    assigned-clocks = <0x2 0x3b>;
    assigned-clock-parents = <0x2 0x57>;
    power-domains = <0x8b 0x7>;
    fifo-depth = <0x100>;
    interrupts = <0x0 0x36 0x4>;
    pinctrl-names = "default";
    pinctrl-0 = <0x90 0x91 0x92 0x93>;
    status = "okay";
    bus-width = <0x4>;
    cap-mmc-highspeed;
    cap-sd-highspeed;
    supports-sd;
    card-detect-delay = <0x320>;
    ignore-pm-notify;
    cd-gpios = <0x5e 0x3 0x1>;
    sd-uhs-sdr12;
    sd-uhs-sdr25;
    sd-uhs-sdr50;
    sd-uhs-sdr104;
    vqmmc-supply = <0x4b>;
    vmmc-supply = <0x94>;
    phandle = <0x111>;
};
/dwmmc@ff380000 {
    compatible = "rockchip,px30-dw-mshc", "rockchip,rk3288-dw-mshc";
    reg = <0x0 0xff380000 0x0 0x4000>;
    max-frequency = <0x8f0d180>;
    clocks = <0x2 0xff 0x2 0x38 0x2 0x45 0x2 0x46>;
    clock-names = "biu", "ciu", "ciu-drv", "ciu-sample";
    assigned-clocks = <0x2 0x38>;
    assigned-clock-parents = <0x2 0x51>;
    power-domains = <0x8b 0xa>;
    fifo-depth = <0x100>;
    interrupts = <0x0 0x37 0x4>;
    pinctrl-names = "default";
    pinctrl-0 = <0x95 0x96 0x97>;
    status = "okay";
    bus-width = <0x4>;
    cap-sd-highspeed;
    supports-rk912;
    supports-sdio;
    no-sd;
    no-mmc;
    ignore-pm-notify;
    keep-power-in-suspend;
    phandle = <0x112>;
};
/dwmmc@ff390000 {
    compatible = "rockchip,px30-dw-mshc", "rockchip,rk3288-dw-mshc";
    reg = <0x0 0xff390000 0x0 0x4000>;
    max-frequency = <0x8f0d180>;
    clocks = <0x2 0x100 0x2 0x39>;
    clock-names = "biu", "ciu";
    assigned-clocks = <0x2 0x39>;
    assigned-clock-parents = <0x2 0x53>;
    power-domains = <0x8b 0xa>;
    fifo-depth = <0x100>;
    interrupts = <0x0 0x35 0x4>;
    status = "disabled";
    bus-width = <0x8>;
    non-removable;
    disable-wp;
    no-sd;
    no-sdio;
    supports-emmc;
    cap-mmc-highspeed;
    vmmc-supply = <0x4d>;
    vqmmc-supply = <0x4c>;
    pinctrl-names = "default";
    pinctrl-0 = <0x98 0x99 0x9a 0x9b 0x9c>;
    num-slots = <0x1>;
    phandle = <0x113>;
};
/nandc@ff3b0000 {
    compatible = "rockchip,rk-nandc";
    reg = <0x0 0xff3b0000 0x0 0x4000>;
    interrupts = <0x0 0x39 0x4>;
    nandc_id = <0x0>;
    clocks = <0x2 0x37 0x2 0xfe>;
    clock-names = "clk_nandc", "hclk_nandc";
    assigned-clocks = <0x2 0x37>;
    assigned-clock-parents = <0x2 0x4f>;
    power-domains = <0x8b 0xa>;
    status = "disabled";
    phandle = <0x114>;
};
/sfc@ff3a0000 {
    compatible = "rockchip,sfc";
    reg = <0x0 0xff3a0000 0x0 0x4000>;
    interrupts = <0x0 0x38 0x4>;
    clocks = <0x2 0x3a 0x2 0x101>;
    clock-names = "clk_sfc", "hclk_sfc";
    assigned-clocks = <0x2 0x3a>;
    assigned-clock-rates = <0x989680>;
    status = "disabled";
    phandle = <0x115>;
};
/gpu@ff400000 {
    compatible = "arm,malit602", "arm,malit60x", "arm,malit6xx", "arm,mali-midgard";
    reg = <0x0 0xff400000 0x0 0x4000>;
    interrupts = <0x0 0x2d 0x4 0x0 0x2e 0x4 0x0 0x2f 0x4>;
    interrupt-names = "GPU", "MMU", "JOB";
    clocks = <0x2 0x49>;
    clock-names = "clk_mali";
    power-domains = <0x8b 0xe>;
    #cooling-cells = <0x2>;
    operating-points-v2 = <0x9d>;
    status = "okay";
    mali-supply = <0xe>;
    phandle = <0x87>;
};
/gpu@ff400000/power_model {
    compatible = "arm,mali-simple-power-model";
    static-coefficient = <0x64578>;
    dynamic-coefficient = <0x2dd>;
    ts = <0x7d00 0x125c 0xffffffb0 0x2>;
    thermal-zone = "gpu-thermal";
};
/gpu-opp-table {
    compatible = "operating-points-v2";
    rockchip,thermal-zone = "soc-thermal";
    rockchip,temp-hysteresis = <0x1388>;
    rockchip,low-temp = <0x0>;
    rockchip,low-temp-min-volt = <0xf4240>;
    rockchip,low-temp-adjust-volt = <0x0 0x1e0 0xc350>;
    rockchip,max-volt = <0x11edd8>;
    rockchip,evb-irdrop = <0x61a8>;
    rockchip,pvtm-voltage-sel = <0x0 0xc350 0x0 0xc351 0xd2f0 0x1 0xd2f1 0xea60 0x2 0xea61 0x1869f 0x3>;
    rockchip,pvtm-ch = <0x0 0x0>;
    phandle = <0x9d>;
};
/gpu-opp-table/opp-400000000 {
    opp-hz = <0x0 0x17d78400>;
    opp-microvolt = <0x100590>;
    opp-microvolt-L0 = <0x100590>;
    opp-microvolt-L1 = <0xfa3e8>;
    opp-microvolt-L2 = <0xee098>;
    opp-microvolt-L3 = <0xe7ef0>;
};
/gpu-opp-table/opp-480000000 {
    opp-hz = <0x0 0x1c9c3800>;
    opp-microvolt = <0x112a88>;
    opp-microvolt-L0 = <0x112a88>;
    opp-microvolt-L1 = <0x10c8e0>;
    opp-microvolt-L2 = <0x100590>;
    opp-microvolt-L3 = <0xf4240>;
};
/gpu-opp-table/opp-520000000 {
    opp-hz = <0x0 0x1efe9200>;
    opp-microvolt = <0x118c30>;
    opp-microvolt-L0 = <0x118c30>;
    opp-microvolt-L1 = <0x118c30>;
    opp-microvolt-L2 = <0x10c8e0>;
    opp-microvolt-L3 = <0x100590>;
};
/hevc_service@ff440000 {
    compatible = "rockchip,hevc_sub";
    iommu_enabled = <0x1>;
    reg = <0x0 0xff440000 0x0 0x400>;
    interrupts = <0x0 0x31 0x4>;
    interrupt-names = "irq_dec";
    dev_mode = <0x1>;
    iommus = <0x9e>;
    allocator = <0x1>;
    phandle = <0xa1>;
};
/vpu_service@ff442000 {
    compatible = "rockchip,vpu_sub";
    iommu_enabled = <0x1>;
    reg = <0x0 0xff442000 0x0 0x800>;
    interrupts = <0x0 0x50 0x4 0x0 0x4f 0x4>;
    interrupt-names = "irq_enc", "irq_dec";
    dev_mode = <0x0>;
    iommus = <0x9f>;
    allocator = <0x1>;
    phandle = <0xa0>;
};
/vpu_combo {
    compatible = "rockchip,vpu_combo";
    subcnt = <0x2>;
    rockchip,grf = <0x2f>;
    rockchip,sub = <0xa0 0xa1>;
    clocks = <0x2 0xaf 0x2 0xf4 0x2 0x4b>;
    clock-names = "aclk_vcodec", "hclk_vcodec", "clk_core";
    resets = <0x2 0x24 0x2 0x26 0x2 0x25 0x2 0x27 0x2 0x3f>;
    reset-names = "video_a", "video_h", "niu_a", "niu_h", "video_core";
    power-domains = <0x8b 0xb>;
    mode_bit = <0xf>;
    mode_ctrl = <0x410>;
    status = "okay";
    phandle = <0x116>;
};
/iommu@ff440440 {
    compatible = "rockchip,iommu";
    reg = <0x0 0xff440440 0x0 0x40 0x0 0xff440480 0x0 0x40>;
    interrupts = <0x0 0x32 0x4>;
    interrupt-names = "hevc_mmu";
    clocks = <0x2 0xaf 0x2 0xf4>;
    clock-names = "aclk", "hclk";
    power-domains = <0x8b 0xb>;
    #iommu-cells = <0x0>;
    phandle = <0x9e>;
};
/iommu@ff442800 {
    compatible = "rockchip,iommu";
    reg = <0x0 0xff442800 0x0 0x100>;
    interrupts = <0x0 0x51 0x4>;
    interrupt-names = "vpu_mmu";
    clocks = <0x2 0xaf 0x2 0xf4>;
    clock-names = "aclk", "hclk";
    power-domains = <0x8b 0xb>;
    #iommu-cells = <0x0>;
    phandle = <0x9f>;
};
/dsi@ff450000 {
    compatible = "rockchip,px30-mipi-dsi";
    reg = <0x0 0xff450000 0x0 0x10000>;
    interrupts = <0x0 0x4b 0x4>;
    clocks = <0x2 0x144 0x4e>;
    clock-names = "pclk", "hs_clk";
    resets = <0x2 0x3d>;
    reset-names = "apb";
    phys = <0x4e>;
    phy-names = "mipi_dphy";
    power-domains = <0x8b 0xc>;
    rockchip,grf = <0x2f>;
    #address-cells = <0x1>;
    #size-cells = <0x0>;
    status = "okay";
    phandle = <0x117>;
};
/dsi@ff450000/ports {
    #address-cells = <0x1>;
    #size-cells = <0x0>;
};
/dsi@ff450000/ports/port@0 {
    reg = <0x0>;
    #address-cells = <0x1>;
    #size-cells = <0x0>;
};
/dsi@ff450000/ports/port@0/endpoint@0 {
    reg = <0x0>;
    remote-endpoint = <0x13>;
    status = "okay";
    phandle = <0xa7>;
};
/dsi@ff450000/panel@0 {
    compatible = "elida,kd35t133", "simple-panel-dsi";
    reg = <0x0>;
    backlight = <0xa2>;
    power-supply = <0xa3>;
    reset-gpios = <0x68 0xf 0x1>;
    prepare-delay-ms = <0x14>;
    reset-delay-ms = <0x14>;
    init-delay-ms = <0x14>;
    enable-delay-ms = <0x78>;
    disable-delay-ms = <0x14>;
    unprepare-delay-ms = <0x14>;
    width-mm = <0x99>;
    height-mm = <0x55>;
    dsi,flags = <0xa03>;
    dsi,format = <0x0>;
    dsi,lanes = <0x4>;
    panel-init-sequence = [15 00 02 ff 30 15 00 02 ff 52 15 00 02 ff 01 15 00 02 e3 00 15 00 02 25 10 15 00 02 28 6f 15 00 02 29 01 15 00 02 2a df 15 00 02 2c 22 15 00 02 c3 0f 15 00 02 37 9c 15 00 02 38 a7 15 00 02 39 41 15 00 02 80 20 15 00 02 91 67 15 00 02 92 67 15 00 02 a0 55 15 00 02 a1 50 15 00 02 a3 58 15 00 02 a4 9c 15 00 02 a7 02 15 00 02 a8 01 15 00 02 a9 21 15 00 02 aa fc 15 00 02 ab 28 15 00 02 ac 06 15 00 02 ad 06 15 00 02 ae 06 15 00 02 af 03 15 00 02 b0 08 15 00 02 b1 26 15 00 02 b2 28 15 00 02 b3 28 15 00 02 b4 03 15 00 02 b5 08 15 00 02 b6 26 15 00 02 b7 08 15 00 02 b8 26 15 00 02 c0 00 15 00 02 c1 00 15 00 02 c2 00 15 00 02 ff 30 15 00 02 ff 52 15 00 02 ff 02 15 00 02 b0 02 15 00 02 d0 02 15 00 02 b1 0f 15 00 02 d1 10 15 00 02 b2 11 15 00 02 d2 12 15 00 02 b3 32 15 00 02 d3 33 15 00 02 b4 36 15 00 02 d4 36 15 00 02 b5 3c 15 00 02 d5 3c 15 00 02 b6 20 15 00 02 d6 20 15 00 02 b7 3e 15 00 02 d7 3e 15 00 02 b8 0e 15 00 02 d8 0d 15 00 02 b9 05 15 00 02 d9 05 15 00 02 ba 11 15 00 02 da 12 15 00 02 bb 11 15 00 02 db 11 15 00 02 bc 13 15 00 02 dc 14 15 00 02 bd 14 15 00 02 dd 14 15 00 02 be 16 15 00 02 de 18 15 00 02 bf 0e 15 00 02 df 0f 15 00 02 c0 17 15 00 02 e0 17 15 00 02 c1 07 15 00 02 e1 08 15 00 02 ff 30 15 00 02 ff 52 15 00 02 ff 03 15 00 02 08 8a 15 00 02 09 8b 15 00 02 30 00 15 00 02 31 00 15 00 02 32 00 15 00 02 33 00 15 00 02 34 61 15 00 02 35 d4 15 00 02 36 24 15 00 02 37 03 15 00 02 40 86 15 00 02 41 87 15 00 02 42 84 15 00 02 43 85 15 00 02 44 11 15 00 02 45 de 15 00 02 46 dd 15 00 02 47 11 15 00 02 48 e0 15 00 02 49 df 15 00 02 50 82 15 00 02 51 83 15 00 02 52 80 15 00 02 53 81 15 00 02 54 11 15 00 02 55 e2 15 00 02 56 e1 15 00 02 57 11 15 00 02 58 e4 15 00 02 59 e3 15 00 02 82 0f 15 00 02 83 0f 15 00 02 84 00 15 00 02 85 0f 15 00 02 86 0f 15 00 02 87 0e 15 00 02 88 0e 15 00 02 89 06 15 00 02 8a 06 15 00 02 8b 07 15 00 02 8c 07 15 00 02 8d 04 15 00 02 8e 04 15 00 02 8f 05 15 00 02 90 05 15 00 02 98 0f 15 00 02 99 0f 15 00 02 9a 00 15 00 02 9b 0f 15 00 02 9c 0f 15 00 02 9d 0e 15 00 02 9e 0e 15 00 02 9f 06 15 00 02 a0 06 15 00 02 a1 07 15 00 02 a2 07 15 00 02 a3 04 15 00 02 a4 04 15 00 02 a5 05 15 00 02 a6 05 15 00 02 e0 02 15 00 02 e1 52 15 00 02 ff 30 15 00 02 ff 52 15 00 02 ff 00 15 00 02 36 02 05 c8 01 11 05 64 01 29];
    panel-exit-sequence = <0x5000128 0x5000110>;
};
/dsi@ff450000/panel@0/display-timings {
    native-mode = <0xa4>;
};
/dsi@ff450000/panel@0/display-timings/adjust {
    clock-frequency = <0x1c9c380>;
    hactive = <0x280>;
    vactive = <0x1e0>;
    hfront-porch = <0xa8>;
    hsync-len = <0x8>;
    hback-porch = <0xa1>;
    vfront-porch = <0x10>;
    vsync-len = <0x2>;
    vback-porch = <0xe>;
    hsync-active = <0x0>;
    vsync-active = <0x0>;
    de-active = <0x0>;
    pixelclk-active = <0x0>;
    phandle = <0xa4>;
};
/dsi@ff450000/panel@0/display-timings/origin {
    clock-frequency = <0x1c9c380>;
    hactive = <0x280>;
    vactive = <0x1e0>;
    hfront-porch = <0x2e>;
    hsync-len = <0x2>;
    hback-porch = <0x2c>;
    vfront-porch = <0x10>;
    vsync-len = <0x2>;
    vback-porch = <0xe>;
    hsync-active = <0x0>;
    vsync-active = <0x0>;
    de-active = <0x0>;
    pixelclk-active = <0x0>;
    phandle = <0x118>;
};
/vop@ff460000 {
    compatible = "rockchip,px30-vop-big";
    reg = <0x0 0xff460000 0x0 0x1fc 0x0 0xff460a00 0x0 0x400>;
    rockchip,grf = <0x2f>;
    reg-names = "regs", "gamma_lut";
    interrupts = <0x0 0x4d 0x4>;
    clocks = <0x2 0xb5 0x2 0x96 0x2 0xfb>;
    clock-names = "aclk_vop", "dclk_vop", "hclk_vop";
    power-domains = <0x8b 0xc>;
    iommus = <0xa5>;
    status = "okay";
    phandle = <0x119>;
};
/vop@ff460000/port {
    #address-cells = <0x1>;
    #size-cells = <0x0>;
    phandle = <0x10>;
};
/vop@ff460000/port/endpoint@0 {
    reg = <0x0>;
    remote-endpoint = <0xa6>;
    phandle = <0x12>;
};
/vop@ff460000/port/endpoint@1 {
    reg = <0x1>;
    remote-endpoint = <0xa7>;
    phandle = <0x13>;
};
/vop@ff460000/port/endpoint@2 {
    reg = <0x2>;
    remote-endpoint = <0xa8>;
    phandle = <0x14>;
};
/iommu@ff460f00 {
    compatible = "rockchip,iommu";
    reg = <0x0 0xff460f00 0x0 0x100>;
    interrupts = <0x0 0x4d 0x4>;
    interrupt-names = "vopb_mmu";
    clocks = <0x2 0xb5 0x2 0xfb>;
    clock-names = "aclk", "hclk";
    power-domains = <0x8b 0xc>;
    #iommu-cells = <0x0>;
    status = "okay";
    phandle = <0xa5>;
};
/rk_rga@ff480000 {
    compatible = "rockchip,rga2";
    reg = <0x0 0xff480000 0x0 0x1000>;
    interrupts = <0x0 0x4c 0x4>;
    clocks = <0x2 0xb7 0x2 0xfd 0x2 0x35>;
    clock-names = "aclk_rga", "hclk_rga", "clk_rga";
    power-domains = <0x8b 0xc>;
    dma-coherent;
    status = "okay";
    phandle = <0x11a>;
};
/cif@ff490000 {
    compatible = "rockchip,cif";
    reg = <0x0 0xff490000 0x0 0x200>;
    interrupts = <0x0 0x45 0x4>;
    clocks = <0x2 0xb3 0x2 0xf9 0x2 0x160 0x2 0x34>;
    clock-names = "aclk_cif0", "hclk_cif0", "pclk_cif", "cif0_out";
    resets = <0x2 0x2c 0x2 0x2d 0x2 0x2e>;
    reset-names = "rst_cif_a", "rst_cif_h", "rst_cif_pclkin";
    power-domains = <0x8b 0xd>;
    pinctrl-names = "cif_pin_all";
    pinctrl-0 = <0xa9>;
    iommus = <0xaa>;
    status = "disabled";
    phandle = <0x11b>;
};
/cif-new@ff490000 {
    compatible = "rockchip,px30-cif";
    reg = <0x0 0xff490000 0x0 0x200>;
    interrupts = <0x0 0x45 0x4>;
    clocks = <0x2 0xb3 0x2 0xf9 0x2 0x160 0x2 0x34>;
    clock-names = "aclk_cif", "hclk_cif", "pclk_cif", "cif_out";
    resets = <0x2 0x2c 0x2 0x2d 0x2 0x2e>;
    reset-names = "rst_cif_a", "rst_cif_h", "rst_cif_pclkin";
    power-domains = <0x8b 0xd>;
    iommus = <0xaa>;
    status = "disabled";
    phandle = <0x11c>;
};
/iommu@ff490800 {
    compatible = "rockchip,iommu";
    reg = <0x0 0xff490800 0x0 0x100>;
    interrupts = <0x0 0x45 0x4>;
    interrupt-names = "vip_mmu";
    clocks = <0x2 0xb3 0x2 0xf9>;
    clock-names = "aclk", "hclk";
    power-domains = <0x8b 0xd>;
    rk_iommu,disable_reset_quirk;
    #iommu-cells = <0x0>;
    status = "disabled";
    phandle = <0xaa>;
};
/rk_isp@ff4a0000 {
    compatible = "rockchip,px30-isp", "rockchip,isp";
    reg = <0x0 0xff4a0000 0x0 0x8000>;
    interrupts = <0x0 0x46 0x4>;
    clocks = <0x2 0xb4 0x2 0xfa 0x2 0x33 0x2 0x33 0x2 0x15f 0x2 0x34 0x2 0x34 0x2 0x146>;
    clock-names = "aclk_isp", "hclk_isp", "clk_isp", "clk_isp_jpe", "pclkin_isp", "clk_cif_pll", "clk_cif_out", "pclk_dphyrx";
    resets = <0x2 0x2b 0x2 0x2f>;
    reset-names = "rst_isp", "rst_mipicsiphy";
    power-domains = <0x8b 0xd>;
    pinctrl-names = "default", "isp_dvp8bit2", "isp_dvp10bit", "isp_dvp12bit";
    pinctrl-0 = <0xab>;
    pinctrl-1 = <0xa9>;
    pinctrl-2 = <0xa9 0xac>;
    pinctrl-3 = <0xad 0xa9 0xac>;
    rockchip,isp,mipiphy = <0x1>;
    rockchip,isp,csiphy,reg = <0xff2f0000 0x4000>;
    rockchip,grf = <0x2f>;
    rockchip,cru = <0x2>;
    rockchip,isp,iommu-enable = <0x1>;
    iommus = <0xae>;
    status = "disabled";
    phandle = <0x11d>;
};
/rkisp1@ff4a0000 {
    compatible = "rockchip,rk3326-rkisp1";
    reg = <0x0 0xff4a0000 0x0 0x8000>;
    interrupts = <0x0 0x46 0x4 0x0 0x49 0x4 0x0 0x4a 0x4>;
    interrupt-names = "isp_irq", "mi_irq", "mipi_irq";
    clocks = <0x2 0xb4 0x2 0xfa 0x2 0x33 0x2 0x15f>;
    clock-names = "aclk_isp", "hclk_isp", "clk_isp", "pclk_isp";
    devfreq = <0xaf>;
    power-domains = <0x8b 0xd>;
    iommus = <0xae>;
    rockchip,grf = <0x2f>;
    status = "okay";
    phandle = <0x11e>;
};
/iommu@ff4a8000 {
    compatible = "rockchip,iommu";
    reg = <0x0 0xff4a8000 0x0 0x100>;
    interrupts = <0x0 0x46 0x4>;
    interrupt-names = "isp_mmu";
    clocks = <0x2 0xb4 0x2 0xfa>;
    clock-names = "aclk", "hclk";
    power-domains = <0x8b 0xd>;
    rk_iommu,disable_reset_quirk;
    #iommu-cells = <0x0>;
    status = "okay";
    phandle = <0xae>;
};
/qos@ff518000 {
    compatible = "syscon";
    reg = <0x0 0xff518000 0x0 0x20>;
    phandle = <0x18>;
};
/qos@ff520000 {
    compatible = "syscon";
    reg = <0x0 0xff520000 0x0 0x20>;
    phandle = <0x28>;
};
/qos@ff52c000 {
    compatible = "syscon";
    reg = <0x0 0xff52c000 0x0 0x20>;
    phandle = <0x17>;
};
/qos@ff538000 {
    compatible = "syscon";
    reg = <0x0 0xff538000 0x0 0x20>;
    phandle = <0x19>;
};
/qos@ff538080 {
    compatible = "syscon";
    reg = <0x0 0xff538080 0x0 0x20>;
    phandle = <0x1a>;
};
/qos@ff538100 {
    compatible = "syscon";
    reg = <0x0 0xff538100 0x0 0x20>;
    phandle = <0x1b>;
};
/qos@ff538180 {
    compatible = "syscon";
    reg = <0x0 0xff538180 0x0 0x20>;
    phandle = <0x1c>;
};
/qos@ff540000 {
    compatible = "syscon";
    reg = <0x0 0xff540000 0x0 0x20>;
    phandle = <0x15>;
};
/qos@ff540080 {
    compatible = "syscon";
    reg = <0x0 0xff540080 0x0 0x20>;
    phandle = <0x16>;
};
/qos@ff548000 {
    compatible = "syscon";
    reg = <0x0 0xff548000 0x0 0x20>;
    phandle = <0x23>;
};
/qos@ff548080 {
    compatible = "syscon";
    reg = <0x0 0xff548080 0x0 0x20>;
    phandle = <0x24>;
};
/qos@ff548100 {
    compatible = "syscon";
    reg = <0x0 0xff548100 0x0 0x20>;
    phandle = <0x25>;
};
/qos@ff548180 {
    compatible = "syscon";
    reg = <0x0 0xff548180 0x0 0x20>;
    phandle = <0x26>;
};
/qos@ff548200 {
    compatible = "syscon";
    reg = <0x0 0xff548200 0x0 0x20>;
    phandle = <0x27>;
};
/qos@ff550000 {
    compatible = "syscon";
    reg = <0x0 0xff550000 0x0 0x20>;
    phandle = <0x1f>;
};
/qos@ff550080 {
    compatible = "syscon";
    reg = <0x0 0xff550080 0x0 0x20>;
    phandle = <0x20>;
};
/qos@ff550100 {
    compatible = "syscon";
    reg = <0x0 0xff550100 0x0 0x20>;
    phandle = <0x21>;
};
/qos@ff550180 {
    compatible = "syscon";
    reg = <0x0 0xff550180 0x0 0x20>;
    phandle = <0x22>;
};
/qos@ff558000 {
    compatible = "syscon";
    reg = <0x0 0xff558000 0x0 0x20>;
    phandle = <0x1d>;
};
/qos@ff558080 {
    compatible = "syscon";
    reg = <0x0 0xff558080 0x0 0x20>;
    phandle = <0x1e>;
};
/dfi@ff610000 {
    reg = <0x0 0xff610000 0x0 0x400>;
    compatible = "rockchip,px30-dfi";
    rockchip,pmugrf = <0xb0>;
    status = "okay";
    phandle = <0xb1>;
};
/dmc {
    compatible = "rockchip,px30-dmc";
    interrupts = <0x0 0x69 0x4>;
    interrupt-names = "complete_irq";
    devfreq-events = <0xb1>;
    clocks = <0x2 0x54>;
    clock-names = "dmc_clk";
    operating-points-v2 = <0xb2>;
    ddr_timing = <0xb3>;
    upthreshold = <0x28>;
    downdifferential = <0x14>;
    system-status-freq = <0x1 0x80e80 0x8 0x6ddd0 0x2 0x2f5d0 0x20 0x6ddd0 0x1000 0x80e80 0x4000 0xa2990 0x2000 0xa2990>;
    auto-min-freq = <0x50140>;
    auto-freq-en = <0x1>;
    #cooling-cells = <0x2>;
    status = "okay";
    center-supply = <0xe>;
    phandle = <0xaf>;
};
/dmc/ddr_power_model {
    compatible = "ddr_power_model";
    dynamic-power-coefficient = <0x78>;
    static-power-coefficient = <0xc8>;
    ts = <0x7d00 0x125c 0xffffffb0 0x2>;
    thermal-zone = "soc-thermal";
    phandle = <0x11f>;
};
/dmc-opp-table {
    compatible = "operating-points-v2";
    rockchip,max-volt = <0x118c30>;
    rockchip,evb-irdrop = <0x61a8>;
    rockchip,pvtm-voltage-sel = <0x0 0xc350 0x0 0xc351 0xd2f0 0x1 0xd2f1 0xea60 0x2 0xea61 0x1869f 0x3>;
    rockchip,pvtm-ch = <0x0 0x0>;
    phandle = <0xb2>;
};
/dmc-opp-table/opp-528000000 {
    opp-hz = <0x0 0x1f78a400>;
    opp-microvolt = <0xee098>;
    opp-microvolt-L0 = <0xee098>;
    opp-microvolt-L1 = <0xee098>;
    opp-microvolt-L2 = <0xe7ef0>;
    opp-microvolt-L3 = <0xe7ef0>;
};
/dmc-opp-table/opp-666000000 {
    opp-hz = <0x0 0x27b25a80>;
    opp-microvolt = <0x100590>;
    opp-microvolt-L0 = <0x100590>;
    opp-microvolt-L1 = <0xf4240>;
    opp-microvolt-L2 = <0xee098>;
    opp-microvolt-L3 = <0xe7ef0>;
};
/dmc-opp-table/opp-786000000 {
    opp-hz = <0x0 0x2ed96880>;
    opp-microvolt = <0x10c8e0>;
    opp-microvolt-L0 = <0x10c8e0>;
    opp-microvolt-L1 = <0x100590>;
    opp-microvolt-L2 = <0xfa3e8>;
    opp-microvolt-L3 = <0xf4240>;
    status = "disabled";
};
/rockchip-system-monitor {
    compatible = "rockchip,system-monitor";
    rockchip,thermal-zone = "soc-thermal";
    rockchip,polling-delay = <0xc8>;
    phandle = <0x120>;
};
/pinctrl {
    compatible = "rockchip,px30-pinctrl";
    rockchip,grf = <0x2f>;
    rockchip,pmu = <0xb0>;
    #address-cells = <0x2>;
    #size-cells = <0x2>;
    ranges;
    phandle = <0x121>;
};
/pinctrl/gpio0@ff040000 {
    compatible = "rockchip,gpio-bank";
    reg = <0x0 0xff040000 0x0 0x100>;
    interrupts = <0x0 0x3 0x4>;
    clocks = <0x2a 0x14>;
    gpio-controller;
    #gpio-cells = <0x2>;
    interrupt-controller;
    #interrupt-cells = <0x2>;
    phandle = <0x5e>;
};
/pinctrl/gpio1@ff250000 {
    compatible = "rockchip,gpio-bank";
    reg = <0x0 0xff250000 0x0 0x100>;
    interrupts = <0x0 0x4 0x4>;
    clocks = <0x2 0x15c>;
    gpio-controller;
    #gpio-cells = <0x2>;
    interrupt-controller;
    #interrupt-cells = <0x2>;
    phandle = <0x122>;
};
/pinctrl/gpio2@ff260000 {
    compatible = "rockchip,gpio-bank";
    reg = <0x0 0xff260000 0x0 0x100>;
    interrupts = <0x0 0x5 0x4>;
    clocks = <0x2 0x15d>;
    gpio-controller;
    #gpio-cells = <0x2>;
    interrupt-controller;
    #interrupt-cells = <0x2>;
    phandle = <0xc3>;
};
/pinctrl/gpio3@ff270000 {
    compatible = "rockchip,gpio-bank";
    reg = <0x0 0xff270000 0x0 0x100>;
    interrupts = <0x0 0x6 0x4>;
    clocks = <0x2 0x15e>;
    gpio-controller;
    #gpio-cells = <0x2>;
    interrupt-controller;
    #interrupt-cells = <0x2>;
    phandle = <0x68>;
};
/pinctrl/pcfg-pull-up {
    bias-pull-up;
    phandle = <0xb6>;
};
/pinctrl/pcfg-pull-down {
    bias-pull-down;
    phandle = <0x123>;
};
/pinctrl/pcfg-pull-none {
    bias-disable;
    phandle = <0xb5>;
};
/pinctrl/pcfg-pull-none-2ma {
    bias-disable;
    drive-strength = <0x2>;
    phandle = <0x124>;
};
/pinctrl/pcfg-pull-up-2ma {
    bias-pull-up;
    drive-strength = <0x2>;
    phandle = <0x125>;
};
/pinctrl/pcfg-pull-up-4ma {
    bias-pull-up;
    drive-strength = <0x4>;
    phandle = <0xb7>;
};
/pinctrl/pcfg-pull-none-4ma {
    bias-disable;
    drive-strength = <0x4>;
    phandle = <0x126>;
};
/pinctrl/pcfg-pull-down-4ma {
    bias-pull-down;
    drive-strength = <0x4>;
    phandle = <0x127>;
};
/pinctrl/pcfg-pull-none-8ma {
    bias-disable;
    drive-strength = <0x8>;
    phandle = <0xba>;
};
/pinctrl/pcfg-pull-up-8ma {
    bias-pull-up;
    drive-strength = <0x8>;
    phandle = <0xb8>;
};
/pinctrl/pcfg-pull-none-12ma {
    bias-disable;
    drive-strength = <0xc>;
    phandle = <0xbc>;
};
/pinctrl/pcfg-pull-up-12ma {
    bias-pull-up;
    drive-strength = <0xc>;
    phandle = <0xbb>;
};
/pinctrl/pcfg-pull-none-smt {
    bias-disable;
    input-schmitt-enable;
    phandle = <0xb4>;
};
/pinctrl/pcfg-output-high {
    output-high;
    phandle = <0xbe>;
};
/pinctrl/pcfg-output-low {
    output-low;
    phandle = <0xbd>;
};
/pinctrl/pcfg-input-high {
    bias-pull-up;
    input-enable;
    phandle = <0xb9>;
};
/pinctrl/pcfg-input {
    input-enable;
    phandle = <0x128>;
};
/pinctrl/i2c0 {
};
/pinctrl/i2c0/i2c0-xfer {
    rockchip,pins = <0x0 0x8 0x1 0xb4 0x0 0x9 0x1 0xb4>;
    phandle = <0x5d>;
};
/pinctrl/i2c1 {
};
/pinctrl/i2c1/i2c1-xfer {
    rockchip,pins = <0x0 0x12 0x1 0xb4 0x0 0x13 0x1 0xb4>;
    phandle = <0x6b>;
};
/pinctrl/i2c2 {
};
/pinctrl/i2c2/i2c2-xfer {
    rockchip,pins = <0x2 0xf 0x2 0xb4 0x2 0x10 0x2 0xb4>;
    phandle = <0x6c>;
};
/pinctrl/i2c3 {
};
/pinctrl/i2c3/i2c3-xfer {
    rockchip,pins = <0x1 0xc 0x4 0xb4 0x1 0xd 0x4 0xb4>;
    phandle = <0x6d>;
};
/pinctrl/tsadc {
};
/pinctrl/tsadc/tsadc-otp-gpio {
    rockchip,pins = <0x0 0x6 0x0 0xb5>;
    phandle = <0x88>;
};
/pinctrl/tsadc/tsadc-otp-out {
    rockchip,pins = <0x0 0x6 0x1 0xb5>;
    phandle = <0x89>;
};
/pinctrl/uart0 {
};
/pinctrl/uart0/uart0-xfer {
    rockchip,pins = <0x0 0xa 0x1 0xb6 0x0 0xb 0x1 0xb6>;
    phandle = <0x2c>;
};
/pinctrl/uart0/uart0-cts {
    rockchip,pins = <0x0 0xc 0x1 0xb5>;
    phandle = <0x2d>;
};
/pinctrl/uart0/uart0-rts {
    rockchip,pins = <0x0 0xd 0x1 0xb5>;
    phandle = <0x2e>;
};
/pinctrl/uart0/uart0-rts-gpio {
    rockchip,pins = <0x0 0xd 0x0 0xb5>;
    phandle = <0x129>;
};
/pinctrl/uart1 {
};
/pinctrl/uart1/uart1-xfer {
    rockchip,pins = <0x1 0x11 0x1 0xb6 0x1 0x10 0x1 0xb6>;
    phandle = <0x51>;
};
/pinctrl/uart1/uart1-cts {
    rockchip,pins = <0x1 0x12 0x1 0xb5>;
    phandle = <0x52>;
};
/pinctrl/uart1/uart1-rts {
    rockchip,pins = <0x1 0x13 0x1 0xb5>;
    phandle = <0x12a>;
};
/pinctrl/uart1/uart1-rts-gpio {
    rockchip,pins = <0x1 0x13 0x0 0xb5>;
    phandle = <0x12b>;
};
/pinctrl/uart2-m0 {
};
/pinctrl/uart2-m0/uart2m0-xfer {
    rockchip,pins = <0x1 0x1a 0x2 0xb6 0x1 0x1b 0x2 0xb6>;
    phandle = <0x12c>;
};
/pinctrl/uart2-m1 {
};
/pinctrl/uart2-m1/uart2m1-xfer {
    rockchip,pins = <0x2 0xc 0x2 0xb6>;
    phandle = <0x53>;
};
/pinctrl/uart3-m0 {
};
/pinctrl/uart3-m0/uart3m0-xfer {
    rockchip,pins = <0x0 0x10 0x2 0xb6 0x0 0x11 0x2 0xb6>;
    phandle = <0x12d>;
};
/pinctrl/uart3-m0/uart3m0-cts {
    rockchip,pins = <0x0 0x12 0x2 0xb5>;
    phandle = <0x12e>;
};
/pinctrl/uart3-m0/uart3m0-rts {
    rockchip,pins = <0x0 0x13 0x2 0xb5>;
    phandle = <0x12f>;
};
/pinctrl/uart3-m0/uart3m0-rts-gpio {
    rockchip,pins = <0x0 0x13 0x0 0xb5>;
    phandle = <0x130>;
};
/pinctrl/uart3-m1 {
};
/pinctrl/uart3-m1/uart3m1-xfer {
    rockchip,pins = <0x1 0xe 0x2 0xb6 0x1 0xf 0x2 0xb6>;
    phandle = <0x54>;
};
/pinctrl/uart3-m1/uart3m1-cts {
    rockchip,pins = <0x1 0xc 0x2 0xb5>;
    phandle = <0x55>;
};
/pinctrl/uart3-m1/uart3m1-rts {
    rockchip,pins = <0x1 0xd 0x2 0xb5>;
    phandle = <0x56>;
};
/pinctrl/uart3-m1/uart3m1-rts-gpio {
    rockchip,pins = <0x1 0xd 0x0 0xb5>;
    phandle = <0x131>;
};
/pinctrl/uart4 {
};
/pinctrl/uart4/uart4-xfer {
    rockchip,pins = <0x1 0x1c 0x2 0xb6 0x1 0x1d 0x2 0xb6>;
    phandle = <0x57>;
};
/pinctrl/uart4/uart4-cts {
    rockchip,pins = <0x1 0x1e 0x2 0xb5>;
    phandle = <0x58>;
};
/pinctrl/uart4/uart4-rts {
    rockchip,pins = <0x1 0x1f 0x2 0xb5>;
    phandle = <0x59>;
};
/pinctrl/uart5 {
};
/pinctrl/uart5/uart5-xfer {
    rockchip,pins = <0x3 0x2 0x4 0xb6 0x3 0x1 0x4 0xb6>;
    phandle = <0x5a>;
};
/pinctrl/uart5/uart5-cts {
    rockchip,pins = <0x3 0x3 0x4 0xb5>;
    phandle = <0x5b>;
};
/pinctrl/uart5/uart5-rts {
    rockchip,pins = <0x3 0x5 0x4 0xb5>;
    phandle = <0x5c>;
};
/pinctrl/spi0 {
};
/pinctrl/spi0/spi0-clk {
    rockchip,pins = <0x1 0xf 0x3 0xb7>;
    phandle = <0x6e>;
};
/pinctrl/spi0/spi0-csn {
    rockchip,pins = <0x1 0xe 0x3 0xb7>;
    phandle = <0x6f>;
};
/pinctrl/spi0/spi0-miso {
    rockchip,pins = <0x1 0xd 0x3 0xb7>;
    phandle = <0x70>;
};
/pinctrl/spi0/spi0-mosi {
    rockchip,pins = <0x1 0xc 0x3 0xb7>;
    phandle = <0x71>;
};
/pinctrl/spi0/spi0-clk-hs {
    rockchip,pins = <0x1 0xf 0x3 0xb8>;
    phandle = <0x72>;
};
/pinctrl/spi0/spi0-miso-hs {
    rockchip,pins = <0x1 0xd 0x3 0xb8>;
    phandle = <0x73>;
};
/pinctrl/spi0/spi0-mosi-hs {
    rockchip,pins = <0x1 0xc 0x3 0xb8>;
    phandle = <0x74>;
};
/pinctrl/spi1 {
};
/pinctrl/spi1/spi1-clk {
    rockchip,pins = <0x3 0xf 0x4 0xb7>;
    phandle = <0x75>;
};
/pinctrl/spi1/spi1-csn0 {
    rockchip,pins = <0x3 0x9 0x4 0xb7>;
    phandle = <0x76>;
};
/pinctrl/spi1/spi1-csn1 {
    rockchip,pins = <0x3 0xa 0x2 0xb7>;
    phandle = <0x77>;
};
/pinctrl/spi1/spi1-miso {
    rockchip,pins = <0x3 0xe 0x4 0xb7>;
    phandle = <0x78>;
};
/pinctrl/spi1/spi1-mosi {
    rockchip,pins = <0x3 0xc 0x4 0xb7>;
    phandle = <0x79>;
};
/pinctrl/spi1/spi1-clk-hs {
    rockchip,pins = <0x3 0xf 0x4 0xb8>;
    phandle = <0x7a>;
};
/pinctrl/spi1/spi1-miso-hs {
    rockchip,pins = <0x3 0xe 0x4 0xb8>;
    phandle = <0x7b>;
};
/pinctrl/spi1/spi1-mosi-hs {
    rockchip,pins = <0x3 0xc 0x4 0xb8>;
    phandle = <0x7c>;
};
/pinctrl/pdm {
};
/pinctrl/pdm/pdm-clk0m0 {
    rockchip,pins = <0x3 0x16 0x2 0xb5>;
    phandle = <0x44>;
};
/pinctrl/pdm/pdm-clk0m1 {
    rockchip,pins = <0x2 0x16 0x1 0xb5>;
    phandle = <0x132>;
};
/pinctrl/pdm/pdm-clk1 {
    rockchip,pins = <0x3 0x17 0x2 0xb5>;
    phandle = <0x45>;
};
/pinctrl/pdm/pdm-sdi0m0 {
    rockchip,pins = <0x3 0x1b 0x2 0xb5>;
    phandle = <0x46>;
};
/pinctrl/pdm/pdm-sdi0m1 {
    rockchip,pins = <0x2 0x15 0x2 0xb5>;
    phandle = <0x133>;
};
/pinctrl/pdm/pdm-sdi1 {
    rockchip,pins = <0x3 0x18 0x2 0xb5>;
    phandle = <0x47>;
};
/pinctrl/pdm/pdm-sdi2 {
    rockchip,pins = <0x3 0x19 0x2 0xb5>;
    phandle = <0x48>;
};
/pinctrl/pdm/pdm-sdi3 {
    rockchip,pins = <0x3 0x1a 0x2 0xb5>;
    phandle = <0x49>;
};
/pinctrl/pdm/pdm-clk0m0-sleep {
    rockchip,pins = <0x3 0x16 0x0 0xb9>;
    phandle = <0x134>;
};
/pinctrl/pdm/pdm-clk0m1-sleep {
    rockchip,pins = <0x2 0x16 0x0 0xb9>;
    phandle = <0x135>;
};
/pinctrl/pdm/pdm-clk1-sleep {
    rockchip,pins = <0x3 0x17 0x0 0xb9>;
    phandle = <0x136>;
};
/pinctrl/pdm/pdm-sdi0m0-sleep {
    rockchip,pins = <0x3 0x1b 0x0 0xb9>;
    phandle = <0x137>;
};
/pinctrl/pdm/pdm-sdi0m1-sleep {
    rockchip,pins = <0x2 0x15 0x0 0xb9>;
    phandle = <0x138>;
};
/pinctrl/pdm/pdm-sdi1-sleep {
    rockchip,pins = <0x3 0x18 0x0 0xb9>;
    phandle = <0x139>;
};
/pinctrl/pdm/pdm-sdi2-sleep {
    rockchip,pins = <0x3 0x19 0x0 0xb9>;
    phandle = <0x13a>;
};
/pinctrl/pdm/pdm-sdi3-sleep {
    rockchip,pins = <0x3 0x1a 0x0 0xb9>;
    phandle = <0x13b>;
};
/pinctrl/i2s0 {
};
/pinctrl/i2s0/i2s0-8ch-mclk {
    rockchip,pins = <0x3 0x11 0x2 0xb5>;
    phandle = <0x13c>;
};
/pinctrl/i2s0/i2s0-8ch-sclktx {
    rockchip,pins = <0x3 0x13 0x2 0xb5>;
    phandle = <0x30>;
};
/pinctrl/i2s0/i2s0-8ch-sclkrx {
    rockchip,pins = <0x3 0xc 0x2 0xb5>;
    phandle = <0x31>;
};
/pinctrl/i2s0/i2s0-8ch-lrcktx {
    rockchip,pins = <0x3 0x12 0x2 0xb5>;
    phandle = <0x32>;
};
/pinctrl/i2s0/i2s0-8ch-lrckrx {
    rockchip,pins = <0x3 0xd 0x2 0xb5>;
    phandle = <0x33>;
};
/pinctrl/i2s0/i2s0-8ch-sdo0 {
    rockchip,pins = <0x3 0x14 0x2 0xb5>;
    phandle = <0x38>;
};
/pinctrl/i2s0/i2s0-8ch-sdo1 {
    rockchip,pins = <0x3 0x10 0x2 0xb5>;
    phandle = <0x39>;
};
/pinctrl/i2s0/i2s0-8ch-sdo2 {
    rockchip,pins = <0x3 0xf 0x2 0xb5>;
    phandle = <0x3a>;
};
/pinctrl/i2s0/i2s0-8ch-sdo3 {
    rockchip,pins = <0x3 0xe 0x2 0xb5>;
    phandle = <0x3b>;
};
/pinctrl/i2s0/i2s0-8ch-sdi0 {
    rockchip,pins = <0x3 0x15 0x2 0xb5>;
    phandle = <0x34>;
};
/pinctrl/i2s0/i2s0-8ch-sdi1 {
    rockchip,pins = <0x3 0xb 0x2 0xb5>;
    phandle = <0x35>;
};
/pinctrl/i2s0/i2s0-8ch-sdi2 {
    rockchip,pins = <0x3 0x9 0x2 0xb5>;
    phandle = <0x36>;
};
/pinctrl/i2s0/i2s0-8ch-sdi3 {
    rockchip,pins = <0x3 0x8 0x2 0xb5>;
    phandle = <0x37>;
};
/pinctrl/i2s1 {
};
/pinctrl/i2s1/i2s1-2ch-mclk {
    rockchip,pins = <0x2 0x13 0x1 0xb5>;
    phandle = <0x6a>;
};
/pinctrl/i2s1/i2s1-2ch-sclk {
    rockchip,pins = <0x2 0x12 0x1 0xb5>;
    phandle = <0x3c>;
};
/pinctrl/i2s1/i2s1-2ch-lrck {
    rockchip,pins = <0x2 0x11 0x1 0xb5>;
    phandle = <0x3d>;
};
/pinctrl/i2s1/i2s1-2ch-sdi {
    rockchip,pins = <0x2 0x15 0x1 0xb5>;
    phandle = <0x3e>;
};
/pinctrl/i2s1/i2s1-2ch-sdo {
    rockchip,pins = <0x2 0x14 0x1 0xb5>;
    phandle = <0x3f>;
};
/pinctrl/i2s2 {
};
/pinctrl/i2s2/i2s2-2ch-mclk {
    rockchip,pins = <0x3 0x1 0x2 0xb5>;
    phandle = <0x13d>;
};
/pinctrl/i2s2/i2s2-2ch-sclk {
    rockchip,pins = <0x3 0x2 0x2 0xb5>;
    phandle = <0x40>;
};
/pinctrl/i2s2/i2s2-2ch-lrck {
    rockchip,pins = <0x3 0x3 0x2 0xb5>;
    phandle = <0x41>;
};
/pinctrl/i2s2/i2s2-2ch-sdi {
    rockchip,pins = <0x3 0x5 0x2 0xb5>;
    phandle = <0x42>;
};
/pinctrl/i2s2/i2s2-2ch-sdo {
    rockchip,pins = <0x3 0x7 0x2 0xb5>;
    phandle = <0x43>;
};
/pinctrl/sdmmc {
};
/pinctrl/sdmmc/sdmmc-clk {
    rockchip,pins = <0x1 0x1e 0x1 0xba>;
    phandle = <0x90>;
};
/pinctrl/sdmmc/sdmmc-cmd {
    rockchip,pins = <0x1 0x1f 0x1 0xb8>;
    phandle = <0x91>;
};
/pinctrl/sdmmc/sdmmc-det {
    rockchip,pins = <0x0 0x3 0x1 0xb8>;
    phandle = <0x92>;
};
/pinctrl/sdmmc/sdmmc-bus1 {
    rockchip,pins = <0x1 0x1a 0x1 0xb8>;
    phandle = <0x13e>;
};
/pinctrl/sdmmc/sdmmc-bus4 {
    rockchip,pins = <0x1 0x1a 0x1 0xb8 0x1 0x1b 0x1 0xb8 0x1 0x1c 0x1 0xb8 0x1 0x1d 0x1 0xb8>;
    phandle = <0x93>;
};
/pinctrl/sdmmc/sdmmc-gpio {
    rockchip,pins = <0x1 0x1a 0x0 0xb7 0x1 0x1b 0x0 0xb7 0x1 0x1c 0x0 0xb7 0x1 0x1d 0x0 0xb7 0x1 0x1e 0x0 0xb7 0x1 0x1f 0x0 0xb7>;
    phandle = <0x13f>;
};
/pinctrl/sdio {
};
/pinctrl/sdio/sdio-clk {
    rockchip,pins = <0x1 0x15 0x1 0xb5>;
    phandle = <0x97>;
};
/pinctrl/sdio/sdio-cmd {
    rockchip,pins = <0x1 0x14 0x1 0xb6>;
    phandle = <0x96>;
};
/pinctrl/sdio/sdio-bus4 {
    rockchip,pins = <0x1 0x16 0x1 0xb6 0x1 0x17 0x1 0xb6 0x1 0x18 0x1 0xb6 0x1 0x19 0x1 0xb6>;
    phandle = <0x95>;
};
/pinctrl/sdio/sdio-gpio {
    rockchip,pins = <0x1 0x16 0x0 0xb6 0x1 0x17 0x0 0xb6 0x1 0x18 0x0 0xb6 0x1 0x19 0x0 0xb6 0x1 0x14 0x0 0xb6 0x1 0x15 0x0 0xb6>;
    phandle = <0x140>;
};
/pinctrl/emmc {
};
/pinctrl/emmc/emmc-clk {
    rockchip,pins = <0x1 0x9 0x2 0xba>;
    phandle = <0x98>;
};
/pinctrl/emmc/emmc-cmd {
    rockchip,pins = <0x1 0xa 0x2 0xb8>;
    phandle = <0x99>;
};
/pinctrl/emmc/emmc-pwren {
    rockchip,pins = <0x1 0x8 0x2 0xb5>;
    phandle = <0x9b>;
};
/pinctrl/emmc/emmc-rstnout {
    rockchip,pins = <0x1 0xb 0x2 0xb5>;
    phandle = <0x9c>;
};
/pinctrl/emmc/emmc-bus1 {
    rockchip,pins = <0x1 0x0 0x2 0xb8>;
    phandle = <0x141>;
};
/pinctrl/emmc/emmc-bus4 {
    rockchip,pins = <0x1 0x0 0x2 0xb8 0x1 0x1 0x2 0xb8 0x1 0x2 0x2 0xb8 0x1 0x3 0x2 0xb8>;
    phandle = <0x142>;
};
/pinctrl/emmc/emmc-bus8 {
    rockchip,pins = <0x1 0x0 0x2 0xb8 0x1 0x1 0x2 0xb8 0x1 0x2 0x2 0xb8 0x1 0x3 0x2 0xb8 0x1 0x4 0x2 0xb8 0x1 0x5 0x2 0xb8 0x1 0x6 0x2 0xb8 0x1 0x7 0x2 0xb8>;
    phandle = <0x9a>;
};
/pinctrl/flash {
};
/pinctrl/flash/flash-cs0 {
    rockchip,pins = <0x1 0x8 0x1 0xb5>;
    phandle = <0x143>;
};
/pinctrl/flash/flash-rdy {
    rockchip,pins = <0x1 0x9 0x1 0xb5>;
    phandle = <0x144>;
};
/pinctrl/flash/flash-dqs {
    rockchip,pins = <0x1 0xa 0x1 0xb5>;
    phandle = <0x145>;
};
/pinctrl/flash/flash-ale {
    rockchip,pins = <0x1 0xb 0x1 0xb5>;
    phandle = <0x146>;
};
/pinctrl/flash/flash-cle {
    rockchip,pins = <0x1 0xc 0x1 0xb5>;
    phandle = <0x147>;
};
/pinctrl/flash/flash-wrn {
    rockchip,pins = <0x1 0xd 0x1 0xb5>;
    phandle = <0x148>;
};
/pinctrl/flash/flash-csl {
    rockchip,pins = <0x1 0xe 0x1 0xb5>;
    phandle = <0x149>;
};
/pinctrl/flash/flash-rdn {
    rockchip,pins = <0x1 0xf 0x1 0xb5>;
    phandle = <0x14a>;
};
/pinctrl/flash/flash-bus8 {
    rockchip,pins = <0x1 0x0 0x1 0xbb 0x1 0x1 0x1 0xbb 0x1 0x2 0x1 0xbb 0x1 0x3 0x1 0xbb 0x1 0x4 0x1 0xbb 0x1 0x5 0x1 0xbb 0x1 0x6 0x1 0xbb 0x1 0x7 0x1 0xbb>;
    phandle = <0x14b>;
};
/pinctrl/lcdc {
};
/pinctrl/lcdc/lcdc-m0-rgb-pins {
    rockchip,pins = <0x3 0x0 0x1 0xba 0x3 0x1 0x1 0xba 0x3 0x2 0x1 0xba 0x3 0x3 0x1 0xba 0x3 0x4 0x1 0xba 0x3 0x5 0x1 0xba 0x3 0x6 0x1 0xba 0x3 0x7 0x1 0xba 0x3 0x8 0x1 0xba 0x3 0x9 0x1 0xba 0x3 0xa 0x1 0xba 0x3 0xb 0x1 0xba 0x3 0xc 0x1 0xba 0x3 0xd 0x1 0xba 0x3 0xe 0x1 0xba 0x3 0xf 0x1 0xba 0x3 0x10 0x1 0xba 0x3 0x11 0x1 0xba 0x3 0x12 0x1 0xba 0x3 0x13 0x1 0xba 0x3 0x14 0x1 0xba 0x3 0x15 0x1 0xba 0x3 0x16 0x1 0xba 0x3 0x17 0x1 0xba 0x3 0x18 0x1 0xba 0x3 0x19 0x1 0xba 0x3 0x1a 0x1 0xba 0x3 0x1b 0x1 0xba>;
    phandle = <0x14c>;
};
/pinctrl/lcdc/lcdc-m0-sleep-pins {
    rockchip,pins = <0x3 0x0 0x0 0xb5 0x3 0x1 0x0 0xb5 0x3 0x2 0x0 0xb5 0x3 0x3 0x0 0xb5 0x3 0x4 0x0 0xb5 0x3 0x5 0x0 0xb5 0x3 0x6 0x0 0xb5 0x3 0x7 0x0 0xb5 0x3 0x8 0x0 0xb5 0x3 0x9 0x0 0xb5 0x3 0xa 0x0 0xb5 0x3 0xb 0x0 0xb5 0x3 0xc 0x0 0xb5 0x3 0xd 0x0 0xb5 0x3 0xe 0x0 0xb5 0x3 0xf 0x0 0xb5 0x3 0x10 0x0 0xb5 0x3 0x11 0x0 0xb5 0x3 0x12 0x0 0xb5 0x3 0x13 0x0 0xb5 0x3 0x14 0x0 0xb5 0x3 0x15 0x0 0xb5 0x3 0x16 0x0 0xb5 0x3 0x17 0x0 0xb5 0x3 0x18 0x0 0xb5 0x3 0x19 0x0 0xb5 0x3 0x1a 0x0 0xb5 0x3 0x1b 0x0 0xb5>;
    phandle = <0x14d>;
};
/pinctrl/lcdc/lcdc-m1-rgb-pins {
    rockchip,pins = <0x3 0x0 0x1 0xba 0x3 0x4 0x1 0xba 0x3 0x6 0x1 0xba 0x3 0xa 0x1 0xba 0x3 0xb 0x1 0xba 0x3 0xd 0x1 0xba 0x3 0x10 0x1 0xba 0x3 0x11 0x1 0xba 0x3 0x12 0x1 0xba 0x3 0x13 0x1 0xba 0x3 0x14 0x1 0xba 0x3 0x15 0x1 0xba 0x3 0x16 0x1 0xba 0x3 0x17 0x1 0xba 0x3 0x18 0x1 0xba 0x3 0x19 0x1 0xba 0x3 0x1a 0x1 0xba 0x3 0x1b 0x1 0xba>;
    phandle = <0x4f>;
};
/pinctrl/lcdc/lcdc-m1-sleep-pins {
    rockchip,pins = <0x3 0x0 0x0 0xb5 0x3 0x4 0x0 0xb5 0x3 0x6 0x0 0xb5 0x3 0xa 0x0 0xb5 0x3 0xb 0x0 0xb5 0x3 0xd 0x0 0xb5 0x3 0x10 0x0 0xb5 0x3 0x11 0x0 0xb5 0x3 0x12 0x0 0xb5 0x3 0x13 0x0 0xb5 0x3 0x14 0x0 0xb5 0x3 0x15 0x0 0xb5 0x3 0x16 0x0 0xb5 0x3 0x17 0x0 0xb5 0x3 0x18 0x0 0xb5 0x3 0x19 0x0 0xb5 0x3 0x1a 0x0 0xb5 0x3 0x1b 0x0 0xb5>;
    phandle = <0x50>;
};
/pinctrl/pwm0 {
};
/pinctrl/pwm0/pwm0-pin {
    rockchip,pins = <0x0 0xf 0x1 0xb5>;
    phandle = <0x7d>;
};
/pinctrl/pwm1 {
};
/pinctrl/pwm1/pwm1-pin {
    rockchip,pins = <0x0 0x10 0x1 0xb5>;
    phandle = <0x7e>;
};
/pinctrl/pwm2 {
};
/pinctrl/pwm2/pwm2-pin {
    rockchip,pins = <0x2 0xd 0x1 0xb5>;
    phandle = <0x7f>;
};
/pinctrl/pwm3 {
};
/pinctrl/pwm3/pwm3-pin {
    rockchip,pins = <0x0 0x11 0x1 0xb5>;
    phandle = <0x80>;
};
/pinctrl/pwm4 {
};
/pinctrl/pwm4/pwm4-pin {
    rockchip,pins = <0x3 0x12 0x3 0xb5>;
    phandle = <0x81>;
};
/pinctrl/pwm5 {
};
/pinctrl/pwm5/pwm5-pin {
    rockchip,pins = <0x3 0x13 0x3 0xb5>;
    phandle = <0x82>;
};
/pinctrl/pwm6 {
};
/pinctrl/pwm6/pwm6-pin {
    rockchip,pins = <0x3 0x14 0x3 0xb5>;
    phandle = <0x83>;
};
/pinctrl/pwm7 {
};
/pinctrl/pwm7/pwm7-pin {
    rockchip,pins = <0x3 0x15 0x3 0xb5>;
    phandle = <0x84>;
};
/pinctrl/gmac {
};
/pinctrl/gmac/rmii-pins {
    rockchip,pins = <0x2 0x0 0x2 0xbc 0x2 0x1 0x2 0xbc 0x2 0x2 0x2 0xbc 0x2 0x3 0x2 0xb5 0x2 0x4 0x2 0xb5 0x2 0x5 0x2 0xb5 0x2 0x6 0x2 0xb5 0x2 0x7 0x2 0xb5 0x2 0x9 0x2 0xb5>;
    phandle = <0x8e>;
};
/pinctrl/gmac/mac-refclk-12ma {
    rockchip,pins = <0x2 0xa 0x2 0xbc>;
    phandle = <0x8f>;
};
/pinctrl/gmac/mac-refclk {
    rockchip,pins = <0x2 0xa 0x2 0xb5>;
    phandle = <0x14e>;
};
/pinctrl/cif-m0 {
};
/pinctrl/cif-m0/cif-clkout-m0 {
    rockchip,pins = <0x2 0xb 0x1 0xbc>;
    phandle = <0xab>;
};
/pinctrl/cif-m0/dvp-d2d9-m0 {
    rockchip,pins = <0x2 0x0 0x1 0xb5 0x2 0x1 0x1 0xb5 0x2 0x2 0x1 0xb5 0x2 0x3 0x1 0xb5 0x2 0x4 0x1 0xb5 0x2 0x5 0x1 0xb5 0x2 0x6 0x1 0xb5 0x2 0x7 0x1 0xb5 0x2 0x8 0x1 0xb5 0x2 0x9 0x1 0xb5 0x2 0xa 0x1 0xb5 0x2 0xb 0x1 0xb5>;
    phandle = <0xa9>;
};
/pinctrl/cif-m0/dvp-d0d1-m0 {
    rockchip,pins = <0x2 0xc 0x1 0xb5 0x2 0xe 0x1 0xb5>;
    phandle = <0xad>;
};
/pinctrl/cif-m0/d10-d11-m0 {
    rockchip,pins = <0x2 0xf 0x1 0xb5 0x2 0x10 0x1 0xb5>;
    phandle = <0xac>;
};
/pinctrl/cif-m1 {
};
/pinctrl/cif-m1/cif-clkout-m1 {
    rockchip,pins = <0x3 0x18 0x3 0xb5>;
    phandle = <0x14f>;
};
/pinctrl/cif-m1/dvp-d2d9-m1 {
    rockchip,pins = <0x3 0x3 0x3 0xb5 0x3 0x5 0x3 0xb5 0x3 0x7 0x3 0xb5 0x3 0x8 0x3 0xb5 0x3 0x9 0x3 0xb5 0x3 0xc 0x3 0xb5 0x3 0xe 0x3 0xb5 0x3 0xf 0x3 0xb5 0x3 0x19 0x3 0xb5 0x3 0x1a 0x3 0xb5 0x3 0x1b 0x3 0xb5 0x3 0x18 0x3 0xb5>;
    phandle = <0x150>;
};
/pinctrl/cif-m1/dvp-d0d1-m1 {
    rockchip,pins = <0x3 0x1 0x3 0xb5 0x3 0x2 0x3 0xb5>;
    phandle = <0x151>;
};
/pinctrl/cif-m1/d10-d11-m1 {
    rockchip,pins = <0x3 0x16 0x3 0xb5 0x3 0x17 0x3 0xb5>;
    phandle = <0x152>;
};
/pinctrl/isp {
};
/pinctrl/isp/isp-prelight {
    rockchip,pins = <0x3 0x19 0x4 0xb5>;
    phandle = <0x153>;
};
/pinctrl/pmic {
};
/pinctrl/pmic/pmic_int {
    rockchip,pins = <0x0 0xa 0x0 0xb6>;
    phandle = <0x5f>;
};
/pinctrl/pmic/soc_slppin_gpio {
    rockchip,pins = <0x0 0x4 0x0 0xbd>;
    phandle = <0x62>;
};
/pinctrl/pmic/soc_slppin_slp {
    rockchip,pins = <0x0 0x4 0x1 0xb5>;
    phandle = <0x60>;
};
/pinctrl/pmic/soc_slppin_rst {
    rockchip,pins = <0x0 0x4 0x2 0xb5>;
    phandle = <0x64>;
};
/pinctrl/vcc18-lcd {
};
/pinctrl/vcc18-lcd/vcc18-lcd-n {
    rockchip,pins = <0x0 0xd 0x0 0xb5>;
    phandle = <0xc8>;
};
/pinctrl/vcc5-usb {
};
/pinctrl/vcc5-usb/vcc5-usb {
    rockchip,pins = <0x3 0x4 0x0 0xb5>;
    phandle = <0xc9>;
};
/pinctrl/sdio-pwrseq {
};
/pinctrl/sdio-pwrseq/wifi-enable-h {
    rockchip,pins = <0x0 0x2 0x0 0xbe>;
};
/pinctrl/btns {
};
/pinctrl/btns/btn-pins {
    rockchip,pins = <0x3 0xb 0x0 0xb6 0x3 0xc 0x0 0xb6 0x3 0xd 0x0 0xb6 0x3 0xe 0x0 0xb6 0x3 0x10 0x0 0xbb 0x3 0x11 0x0 0xbb 0x3 0x12 0x0 0xbb 0x3 0x13 0x0 0xbb 0x3 0x14 0x0 0xbb 0x3 0x15 0x0 0xbb 0x3 0x16 0x0 0xbb 0x3 0x17 0x0 0xbb 0x3 0x18 0x0 0xb6 0x3 0x19 0x0 0xb6 0x3 0x1a 0x0 0xb6 0x3 0x1b 0x0 0xb6 0x2 0xd 0x0 0xb6 0x2 0xe 0x0 0xb6 0x3 0xa 0x0 0xb6>;
    phandle = <0xc2>;
};
/pinctrl/headphone {
};
/pinctrl/headphone/hp-det {
    rockchip,pins = <0x2 0x16 0x0 0xb6>;
    phandle = <0xc5>;
};
/chosen {
    bootargs = [00];
};
/fiq-debugger {
    compatible = "rockchip,fiq-debugger";
    rockchip,serial-id = <0x5>;
    rockchip,wake-irq = <0x0>;
    rockchip,irq-mode-enable = <0x1>;
    rockchip,baudrate = <0x16e360>;
    interrupts = <0x0 0x7f 0x8>;
    pinctrl-names = "default";
    pinctrl-0 = <0x5a>;
    status = "okay";
};
/ramoops {
    compatible = "ramoops";
    record-size = <0x0 0x20000>;
    console-size = <0x0 0x80000>;
    ftrace-size = <0x0 0x0>;
    pmsg-size = <0x0 0x0>;
    memory-region = <0xbf>;
};
/reserved-memory {
    #address-cells = <0x2>;
    #size-cells = <0x2>;
    ranges;
};
/reserved-memory/drm-logo@00000000 {
    compatible = "rockchip,drm-logo";
    reg = <0x0 0x0 0x0 0x0>;
    phandle = <0x11>;
};
/reserved-memory/region@110000 {
    reg = <0x0 0x110000 0x0 0xf0000>;
    reg-names = "ramoops_mem";
    phandle = <0xbf>;
};
/rg351-keys {
    compatible = "rockchip,key";
    io-channels = <0xc0 0x2>;
    poll-interval = <0x32>;
    autorepeat;
    repeat-delay-ms = <0x12c>;
    repeat-period-ms = <0x28>;
    phandle = <0x154>;
};
/rg351-keys/vol-down-key {
    linux,code = <0x72>;
    label = "volume down";
    rockchip,adc_value = <0xa6>;
};
/rg351-keys/vol-up-key {
    linux,code = <0x73>;
    label = "volume up";
    rockchip,adc_value = <0x9>;
};
/odroidgo3-joypad {
    compatible = "odroidgo3-joypad";
    pwms = <0xc1 0x0 0xbebc200 0x0>;
    pwm-names = "enable";
    rumble-boost-weak = <0x0>;
    rumble-boost-strong = <0x0>;
    joypad-name = "GO-Super Gamepad";
    joypad-product = <0x1100>;
    joypad-revision = <0x100>;
    status = "okay";
    pinctrl-names = "default";
    pinctrl-0 = <0xc2>;
    pinctrl-1 = <0x7d>;
    io-channel-names = "amux_adc";
    io-channels = <0xc0 0x1>;
    amux-count = <0x4>;
    amux-channel-mapping = <0x2 0x3 0x1 0x0>;
    amux-a-gpios = <0xc3 0x10 0x1>;
    amux-b-gpios = <0xc3 0xf 0x1>;
    button-adc-scale = <0x2>;
    button-adc-deadzone = <0x40>;
    button-adc-fuzz = <0x20>;
    button-adc-flat = <0x20>;
    abs_x-p-tuning = <0xc8>;
    abs_x-n-tuning = <0xc8>;
    abs_y-p-tuning = <0xc8>;
    abs_y-n-tuning = <0xc8>;
    abs_rx-p-tuning = <0xc8>;
    abs_rx-n-tuning = <0xc8>;
    abs_ry-p-tuning = <0xc8>;
    abs_ry-n-tuning = <0xc8>;
    poll-interval = <0xa>;
    invert-absx;
    invert-absy;
    invert-absrx;
    invert-absry;
    phandle = <0x155>;
};
/odroidgo3-joypad/sw1 {
    gpios = <0x68 0x16 0x1>;
    label = "GPIO DPAD-UP";
    linux,code = <0x220>;
};
/odroidgo3-joypad/sw2 {
    gpios = <0x68 0x17 0x1>;
    label = "GPIO DPAD-DOWN";
    linux,code = <0x221>;
};
/odroidgo3-joypad/sw3 {
    gpios = <0x68 0x14 0x1>;
    label = "GPIO DPAD-LEFT";
    linux,code = <0x222>;
};
/odroidgo3-joypad/sw4 {
    gpios = <0x68 0x15 0x1>;
    label = "GPIO DPAD-RIGHT";
    linux,code = <0x223>;
};
/odroidgo3-joypad/sw5 {
    gpios = <0x68 0x10 0x1>;
    label = "GPIO BTN-A";
    linux,code = <0x131>;
};
/odroidgo3-joypad/sw6 {
    gpios = <0x68 0x11 0x1>;
    label = "GPIO BTN-B";
    linux,code = <0x130>;
};
/odroidgo3-joypad/sw7 {
    gpios = <0x68 0x13 0x1>;
    label = "GPIO BTN-Y";
    linux,code = <0x134>;
};
/odroidgo3-joypad/sw8 {
    gpios = <0x68 0x12 0x1>;
    label = "GPIO BTN-X";
    linux,code = <0x133>;
};
/odroidgo3-joypad/sw11 {
    gpios = <0xc3 0xe 0x1>;
    label = "BTN_THUMBR";
    linux,code = <0x2c3>;
};
/odroidgo3-joypad/sw12 {
    gpios = <0xc3 0xd 0x1>;
    label = "BTN_THUMBL";
    linux,code = <0x2c2>;
};
/odroidgo3-joypad/sw13 {
    gpios = <0x68 0xa 0x1>;
    label = "GPIO BTN_F";
    linux,code = <0x2c4>;
};
/odroidgo3-joypad/sw15 {
    gpios = <0x68 0xd 0x1>;
    label = "GPIO BTN_TL";
    linux,code = <0x136>;
};
/odroidgo3-joypad/sw16 {
    gpios = <0x68 0xb 0x1>;
    label = "GPIO BTN_TR";
    linux,code = <0x137>;
};
/odroidgo3-joypad/sw19 {
    gpios = <0x68 0x18 0x1>;
    label = "BTN_SELECT";
    linux,code = <0x2c0>;
};
/odroidgo3-joypad/sw20 {
    gpios = <0x68 0xc 0x1>;
    label = "GPIO BTN_TR2";
    linux,code = <0x139>;
};
/odroidgo3-joypad/sw21 {
    gpios = <0x68 0xe 0x1>;
    label = "GPIO BTN_TL2";
    linux,code = <0x138>;
};
/odroidgo3-joypad/sw22 {
    gpios = <0x68 0x19 0x1>;
    label = "BTN_START";
    linux,code = <0x2c1>;
};
/backlight {
    compatible = "pwm-backlight";
    power-supply = <0x4a>;
    pwms = <0xc4 0x0 0x61a8 0x0>;
    brightness-levels = <0x0 0x1 0x2 0x3 0x4 0x5 0x6 0x7 0x8 0x9 0xa 0xb 0xc 0xd 0xe 0xf 0x10 0x11 0x12 0x13 0x14 0x15 0x16 0x17 0x18 0x19 0x1a 0x1b 0x1c 0x1d 0x1e 0x1f 0x20 0x21 0x22 0x23 0x24 0x25 0x26 0x27 0x28 0x29 0x2a 0x2b 0x2c 0x2d 0x2e 0x2f 0x30 0x31 0x32 0x33 0x34 0x35 0x36 0x37 0x38 0x39 0x3a 0x3b 0x3c 0x3d 0x3e 0x3f 0x40 0x41 0x42 0x43 0x44 0x45 0x46 0x47 0x48 0x49 0x4a 0x4b 0x4c 0x4d 0x4e 0x4f 0x50 0x51 0x52 0x53 0x54 0x55 0x56 0x57 0x58 0x59 0x5a 0x5b 0x5c 0x5d 0x5e 0x5f 0x60 0x61 0x62 0x63 0x64 0x65 0x66 0x67 0x68 0x69 0x6a 0x6b 0x6c 0x6d 0x6e 0x6f 0x70 0x71 0x72 0x73 0x74 0x75 0x76 0x77 0x78 0x79 0x7a 0x7b 0x7c 0x7d 0x7e 0x7f 0x80 0x81 0x82 0x83 0x84 0x85 0x86 0x87 0x88 0x89 0x8a 0x8b 0x8c 0x8d 0x8e 0x8f 0x90 0x91 0x92 0x93 0x94 0x95 0x96 0x97 0x98 0x99 0x9a 0x9b 0x9c 0x9d 0x9e 0x9f 0xa0 0xa1 0xa2 0xa3 0xa4 0xa5 0xa6 0xa7 0xa8 0xa9 0xaa 0xab 0xac 0xad 0xae 0xaf 0xb0 0xb1 0xb2 0xb3 0xb4 0xb5 0xb6 0xb7 0xb8 0xb9 0xba 0xbb 0xbc 0xbd 0xbe 0xbf 0xc0 0xc1 0xc2 0xc3 0xc4 0xc5 0xc6 0xc7 0xc8 0xc9 0xca 0xcb 0xcc 0xcd 0xce 0xcf 0xd0 0xd1 0xd2 0xd3 0xd4 0xd5 0xd6 0xd7 0xd8 0xd9 0xda 0xdb 0xdc 0xdd 0xde 0xdf 0xe0 0xe1 0xe2 0xe3 0xe4 0xe5 0xe6 0xe7 0xe8 0xe9 0xea 0xeb 0xec 0xed 0xee 0xef 0xf0 0xf1 0xf2 0xf3 0xf4 0xf5 0xf6 0xf7 0xf8 0xf9 0xfa 0xfb 0xfc 0xfd 0xfe 0xff>;
    default-brightness-level = <0xc8>;
    phandle = <0xa2>;
};
/rk817-sound {
    compatible = "simple-audio-card";
    simple-audio-card,format = "i2s";
    simple-audio-card,name = "rockchip,rk817-codec";
    simple-audio-card,mclk-fs = <0x100>;
    simple-audio-card,widgets = "Microphone", "Mic Jack", "Headphone", "Headphone Jack";
    simple-audio-card,routing = "MIC_IN", "Mic Jack", "Headphone Jack", "HPOL", "Headphone Jack", "HPOR";
    simple-audio-card,hp-det-gpio = <0xc3 0x16 0x1>;
    pinctrl-names = "default";
    pinctrl-0 = <0xc5>;
};
/rk817-sound/simple-audio-card,cpu {
    sound-dai = <0xc6>;
};
/rk817-sound/simple-audio-card,codec {
    sound-dai = <0xc7>;
};
/vccsys {
    compatible = "regulator-fixed";
    regulator-name = "vcc3v8_sys";
    regulator-always-on;
    regulator-min-microvolt = <0x39fbc0>;
    regulator-max-microvolt = <0x39fbc0>;
    phandle = <0x66>;
};
/wireless-wlan {
    compatible = "wlan-platdata";
    wifi_chip_type = "rk915";
    WIFI,host_wake_irq = <0x5e 0x5 0x0>;
    WIFI,poweren_gpio = <0x5e 0x2 0x0>;
    status = "okay";
    phandle = <0x156>;
};
/vcc18_lcd0 {
    compatible = "regulator-fixed";
    regulator-name = "vcc18_lcd0_n";
    regulator-min-microvolt = <0x1b7740>;
    regulator-max-microvolt = <0x1b7740>;
    gpio = <0x5e 0xd 0x0>;
    pinctrl-0 = <0xc8>;
    pinctrl-names = "default";
    enable-active-high;
    regulator-boot-on;
    phandle = <0xa3>;
};
/vcc18_lcd0/regulator-state-mem {
    regulator-off-in-suspend;
};
/vcc_host {
    compatible = "regulator-fixed";
    regulator-name = "vcc_host";
    regulator-min-microvolt = <0x4c4b40>;
    regulator-max-microvolt = <0x4c4b40>;
    gpio = <0x68 0x4 0x0>;
    pinctrl-0 = <0xc9>;
    pinctrl-names = "default";
    enable-active-high;
    regulator-always-on;
    vin-supply = <0x67>;
    phandle = <0x157>;
};
/__symbols__ {
    ddr_timing = "/ddr_timing";
    cpu0 = "/cpus/cpu@0";
    cpu1 = "/cpus/cpu@1";
    cpu2 = "/cpus/cpu@2";
    cpu3 = "/cpus/cpu@3";
    CPU_SLEEP = "/cpus/idle-states/cpu-sleep";
    CLUSTER_SLEEP = "/cpus/idle-states/cluster-sleep";
    cpu0_opp_table = "/cpu0-opp-table";
    bus_soc = "/bus-soc";
    bus_apll = "/bus-apll";
    bus_apll_opp_table = "/bus-apll-opp-table";
    display_subsystem = "/display-subsystem";
    route_lvds = "/display-subsystem/route/route-lvds";
    route_dsi = "/display-subsystem/route/route-dsi";
    route_rgb = "/display-subsystem/route/route-rgb";
    gmac_clkin = "/external-gmac-clock";
    rockchip_suspend = "/rockchip-suspend";
    xin24m = "/xin24m";
    xin32k = "/xin32k";
    pmu = "/power-management@ff000000";
    power = "/power-management@ff000000/power-controller";
    pmugrf = "/syscon@ff010000";
    pmu_io_domains = "/syscon@ff010000/io-domains";
    pmu_pvtm = "/syscon@ff010000/pmu-pvtm";
    uart0 = "/serial@ff030000";
    i2s0_8ch = "/i2s@ff060000";
    i2s1_2ch = "/i2s@ff070000";
    i2s2_2ch = "/i2s@ff080000";
    pdm = "/pdm@ff0a0000";
    crypto = "/crypto@ff0b0000";
    rng = "/rng@ff0b0000";
    gic = "/interrupt-controller@ff131000";
    grf = "/syscon@ff140000";
    io_domains = "/syscon@ff140000/io-domains";
    lvds = "/syscon@ff140000/lvds";
    lvds_in_vopb = "/syscon@ff140000/lvds/ports/port@0/endpoint@0";
    rgb = "/syscon@ff140000/rgb";
    rgb_in_vopb = "/syscon@ff140000/rgb/ports/port@0/endpoint@0";
    core_grf = "/syscon@ff148000";
    pvtm = "/syscon@ff148000/pvtm";
    uart1 = "/serial@ff158000";
    uart2 = "/serial@ff160000";
    uart3 = "/serial@ff168000";
    uart4 = "/serial@ff170000";
    uart5 = "/serial@ff178000";
    i2c0 = "/i2c@ff180000";
    rk817 = "/i2c@ff180000/pmic@20";
    pinctrl_rk8xx = "/i2c@ff180000/pmic@20/pinctrl_rk8xx";
    rk817_ts_gpio1 = "/i2c@ff180000/pmic@20/pinctrl_rk8xx/rk817_ts_gpio1";
    rk817_gt_gpio2 = "/i2c@ff180000/pmic@20/pinctrl_rk8xx/rk817_gt_gpio2";
    rk817_pin_ts = "/i2c@ff180000/pmic@20/pinctrl_rk8xx/rk817_pin_ts";
    rk817_pin_gt = "/i2c@ff180000/pmic@20/pinctrl_rk8xx/rk817_pin_gt";
    rk817_slppin_null = "/i2c@ff180000/pmic@20/pinctrl_rk8xx/rk817_slppin_null";
    rk817_slppin_slp = "/i2c@ff180000/pmic@20/pinctrl_rk8xx/rk817_slppin_slp";
    rk817_slppin_pwrdn = "/i2c@ff180000/pmic@20/pinctrl_rk8xx/rk817_slppin_pwrdn";
    rk817_slppin_rst = "/i2c@ff180000/pmic@20/pinctrl_rk8xx/rk817_slppin_rst";
    vdd_logic = "/i2c@ff180000/pmic@20/regulators/DCDC_REG1";
    vdd_arm = "/i2c@ff180000/pmic@20/regulators/DCDC_REG2";
    vcc_ddr = "/i2c@ff180000/pmic@20/regulators/DCDC_REG3";
    vcc_3v0 = "/i2c@ff180000/pmic@20/regulators/DCDC_REG4";
    vcc3v3_sys = "/i2c@ff180000/pmic@20/regulators/DCDC_REG5";
    vcc_1v0 = "/i2c@ff180000/pmic@20/regulators/LDO_REG1";
    vcc1v8_soc = "/i2c@ff180000/pmic@20/regulators/LDO_REG2";
    vcc1v0_soc = "/i2c@ff180000/pmic@20/regulators/LDO_REG3";
    vcc3v0_pmu = "/i2c@ff180000/pmic@20/regulators/LDO_REG4";
    vccio_sd = "/i2c@ff180000/pmic@20/regulators/LDO_REG5";
    vcc_sd = "/i2c@ff180000/pmic@20/regulators/LDO_REG6";
    vcc_backlight = "/i2c@ff180000/pmic@20/regulators/LDO_REG7";
    vcc_lcd = "/i2c@ff180000/pmic@20/regulators/LDO_REG8";
    vdd1v5_dvp = "/i2c@ff180000/pmic@20/regulators/LDO_REG9";
    vcc5v0_host = "/i2c@ff180000/pmic@20/regulators/SWITCH_REG1";
    vcc3v3_lcd = "/i2c@ff180000/pmic@20/regulators/SWITCH_REG2";
    dcdc_boost = "/i2c@ff180000/pmic@20/regulators/BOOST";
    otg_switch = "/i2c@ff180000/pmic@20/regulators/OTG_SWITCH";
    rk817_codec = "/i2c@ff180000/pmic@20/codec";
    i2c1 = "/i2c@ff190000";
    i2c2 = "/i2c@ff1a0000";
    i2c3 = "/i2c@ff1b0000";
    spi0 = "/spi@ff1d0000";
    spi1 = "/spi@ff1d8000";
    wdt = "/watchdog@ff1e0000";
    pwm0 = "/pwm@ff200000";
    pwm1 = "/pwm@ff200010";
    pwm2 = "/pwm@ff200020";
    pwm3 = "/pwm@ff200030";
    pwm4 = "/pwm@ff208000";
    pwm5 = "/pwm@ff208010";
    pwm6 = "/pwm@ff208020";
    pwm7 = "/pwm@ff208030";
    rktimer = "/rktimer@ff210000";
    dmac = "/amba/dmac@ff240000";
    thermal_zones = "/thermal-zones";
    soc_thermal = "/thermal-zones/soc-thermal";
    threshold = "/thermal-zones/soc-thermal/trips/trip-point-0";
    target = "/thermal-zones/soc-thermal/trips/trip-point-1";
    soc_crit = "/thermal-zones/soc-thermal/trips/soc-crit";
    gpu_thermal = "/thermal-zones/gpu-thermal";
    tsadc = "/tsadc@ff280000";
    saradc = "/saradc@ff288000";
    otp = "/otp@ff290000";
    otp_id = "/otp@ff290000/id@7";
    cpu_leakage = "/otp@ff290000/cpu-leakage@17";
    performance = "/otp@ff290000/performance@1e";
    cru = "/clock-controller@ff2b0000";
    cpu_boost = "/cpu-boost@ff2b8000";
    pmucru = "/pmu-clock-controller@ff2bc000";
    usb2phy_grf = "/syscon@ff2c0000";
    u2phy = "/syscon@ff2c0000/usb2-phy@100";
    u2phy_host = "/syscon@ff2c0000/usb2-phy@100/host-port";
    u2phy_otg = "/syscon@ff2c0000/usb2-phy@100/otg-port";
    video_phy = "/video-phy@ff2e0000";
    mipi_dphy_rx0 = "/mipi-dphy-rx0@ff2f0000";
    usb20_otg = "/usb@ff300000";
    usb_host0_ehci = "/usb@ff340000";
    usb_host0_ohci = "/usb@ff350000";
    gmac = "/ethernet@ff360000";
    sdmmc = "/dwmmc@ff370000";
    sdio = "/dwmmc@ff380000";
    emmc = "/dwmmc@ff390000";
    nandc0 = "/nandc@ff3b0000";
    sfc = "/sfc@ff3a0000";
    gpu = "/gpu@ff400000";
    gpu_opp_table = "/gpu-opp-table";
    hevc = "/hevc_service@ff440000";
    vpu = "/vpu_service@ff442000";
    vpu_combo = "/vpu_combo";
    hevc_mmu = "/iommu@ff440440";
    vpu_mmu = "/iommu@ff442800";
    dsi = "/dsi@ff450000";
    dsi_in_vopb = "/dsi@ff450000/ports/port@0/endpoint@0";
    timing0 = "/dsi@ff450000/panel@0/display-timings/adjust";
    timing1 = "/dsi@ff450000/panel@0/display-timings/origin";
    vopb = "/vop@ff460000";
    vopb_out = "/vop@ff460000/port";
    vopb_out_lvds = "/vop@ff460000/port/endpoint@0";
    vopb_out_dsi = "/vop@ff460000/port/endpoint@1";
    vopb_out_rgb = "/vop@ff460000/port/endpoint@2";
    vopb_mmu = "/iommu@ff460f00";
    rk_rga = "/rk_rga@ff480000";
    cif = "/cif@ff490000";
    cif_new = "/cif-new@ff490000";
    vip_mmu = "/iommu@ff490800";
    rk_isp = "/rk_isp@ff4a0000";
    rkisp1 = "/rkisp1@ff4a0000";
    isp_mmu = "/iommu@ff4a8000";
    qos_gmac = "/qos@ff518000";
    qos_gpu = "/qos@ff520000";
    qos_sdmmc = "/qos@ff52c000";
    qos_emmc = "/qos@ff538000";
    qos_nand = "/qos@ff538080";
    qos_sdio = "/qos@ff538100";
    qos_sfc = "/qos@ff538180";
    qos_usb_host = "/qos@ff540000";
    qos_usb_otg = "/qos@ff540080";
    qos_isp_128 = "/qos@ff548000";
    qos_isp_rd = "/qos@ff548080";
    qos_isp_wr = "/qos@ff548100";
    qos_isp_m1 = "/qos@ff548180";
    qos_vip = "/qos@ff548200";
    qos_rga_rd = "/qos@ff550000";
    qos_rga_wr = "/qos@ff550080";
    qos_vop_m0 = "/qos@ff550100";
    qos_vop_m1 = "/qos@ff550180";
    qos_vpu = "/qos@ff558000";
    qos_vpu_r128 = "/qos@ff558080";
    dfi = "/dfi@ff610000";
    dmc = "/dmc";
    ddr_power_model = "/dmc/ddr_power_model";
    dmc_opp_table = "/dmc-opp-table";
    rockchip_system_monitor = "/rockchip-system-monitor";
    pinctrl = "/pinctrl";
    gpio0 = "/pinctrl/gpio0@ff040000";
    gpio1 = "/pinctrl/gpio1@ff250000";
    gpio2 = "/pinctrl/gpio2@ff260000";
    gpio3 = "/pinctrl/gpio3@ff270000";
    pcfg_pull_up = "/pinctrl/pcfg-pull-up";
    pcfg_pull_down = "/pinctrl/pcfg-pull-down";
    pcfg_pull_none = "/pinctrl/pcfg-pull-none";
    pcfg_pull_none_2ma = "/pinctrl/pcfg-pull-none-2ma";
    pcfg_pull_up_2ma = "/pinctrl/pcfg-pull-up-2ma";
    pcfg_pull_up_4ma = "/pinctrl/pcfg-pull-up-4ma";
    pcfg_pull_none_4ma = "/pinctrl/pcfg-pull-none-4ma";
    pcfg_pull_down_4ma = "/pinctrl/pcfg-pull-down-4ma";
    pcfg_pull_none_8ma = "/pinctrl/pcfg-pull-none-8ma";
    pcfg_pull_up_8ma = "/pinctrl/pcfg-pull-up-8ma";
    pcfg_pull_none_12ma = "/pinctrl/pcfg-pull-none-12ma";
    pcfg_pull_up_12ma = "/pinctrl/pcfg-pull-up-12ma";
    pcfg_pull_none_smt = "/pinctrl/pcfg-pull-none-smt";
    pcfg_output_high = "/pinctrl/pcfg-output-high";
    pcfg_output_low = "/pinctrl/pcfg-output-low";
    pcfg_input_high = "/pinctrl/pcfg-input-high";
    pcfg_input = "/pinctrl/pcfg-input";
    i2c0_xfer = "/pinctrl/i2c0/i2c0-xfer";
    i2c1_xfer = "/pinctrl/i2c1/i2c1-xfer";
    i2c2_xfer = "/pinctrl/i2c2/i2c2-xfer";
    i2c3_xfer = "/pinctrl/i2c3/i2c3-xfer";
    tsadc_otp_gpio = "/pinctrl/tsadc/tsadc-otp-gpio";
    tsadc_otp_out = "/pinctrl/tsadc/tsadc-otp-out";
    uart0_xfer = "/pinctrl/uart0/uart0-xfer";
    uart0_cts = "/pinctrl/uart0/uart0-cts";
    uart0_rts = "/pinctrl/uart0/uart0-rts";
    uart0_rts_gpio = "/pinctrl/uart0/uart0-rts-gpio";
    uart1_xfer = "/pinctrl/uart1/uart1-xfer";
    uart1_cts = "/pinctrl/uart1/uart1-cts";
    uart1_rts = "/pinctrl/uart1/uart1-rts";
    uart1_rts_gpio = "/pinctrl/uart1/uart1-rts-gpio";
    uart2m0_xfer = "/pinctrl/uart2-m0/uart2m0-xfer";
    uart2m1_xfer = "/pinctrl/uart2-m1/uart2m1-xfer";
    uart3m0_xfer = "/pinctrl/uart3-m0/uart3m0-xfer";
    uart3m0_cts = "/pinctrl/uart3-m0/uart3m0-cts";
    uart3m0_rts = "/pinctrl/uart3-m0/uart3m0-rts";
    uart3m0_rts_gpio = "/pinctrl/uart3-m0/uart3m0-rts-gpio";
    uart3m1_xfer = "/pinctrl/uart3-m1/uart3m1-xfer";
    uart3m1_cts = "/pinctrl/uart3-m1/uart3m1-cts";
    uart3m1_rts = "/pinctrl/uart3-m1/uart3m1-rts";
    uart3m1_rts_gpio = "/pinctrl/uart3-m1/uart3m1-rts-gpio";
    uart4_xfer = "/pinctrl/uart4/uart4-xfer";
    uart4_cts = "/pinctrl/uart4/uart4-cts";
    uart4_rts = "/pinctrl/uart4/uart4-rts";
    uart5_xfer = "/pinctrl/uart5/uart5-xfer";
    uart5_cts = "/pinctrl/uart5/uart5-cts";
    uart5_rts = "/pinctrl/uart5/uart5-rts";
    spi0_clk = "/pinctrl/spi0/spi0-clk";
    spi0_csn = "/pinctrl/spi0/spi0-csn";
    spi0_miso = "/pinctrl/spi0/spi0-miso";
    spi0_mosi = "/pinctrl/spi0/spi0-mosi";
    spi0_clk_hs = "/pinctrl/spi0/spi0-clk-hs";
    spi0_miso_hs = "/pinctrl/spi0/spi0-miso-hs";
    spi0_mosi_hs = "/pinctrl/spi0/spi0-mosi-hs";
    spi1_clk = "/pinctrl/spi1/spi1-clk";
    spi1_csn0 = "/pinctrl/spi1/spi1-csn0";
    spi1_csn1 = "/pinctrl/spi1/spi1-csn1";
    spi1_miso = "/pinctrl/spi1/spi1-miso";
    spi1_mosi = "/pinctrl/spi1/spi1-mosi";
    spi1_clk_hs = "/pinctrl/spi1/spi1-clk-hs";
    spi1_miso_hs = "/pinctrl/spi1/spi1-miso-hs";
    spi1_mosi_hs = "/pinctrl/spi1/spi1-mosi-hs";
    pdm_clk0m0 = "/pinctrl/pdm/pdm-clk0m0";
    pdm_clk0m1 = "/pinctrl/pdm/pdm-clk0m1";
    pdm_clk1 = "/pinctrl/pdm/pdm-clk1";
    pdm_sdi0m0 = "/pinctrl/pdm/pdm-sdi0m0";
    pdm_sdi0m1 = "/pinctrl/pdm/pdm-sdi0m1";
    pdm_sdi1 = "/pinctrl/pdm/pdm-sdi1";
    pdm_sdi2 = "/pinctrl/pdm/pdm-sdi2";
    pdm_sdi3 = "/pinctrl/pdm/pdm-sdi3";
    pdm_clk0m0_sleep = "/pinctrl/pdm/pdm-clk0m0-sleep";
    pdm_clk0m_sleep1 = "/pinctrl/pdm/pdm-clk0m1-sleep";
    pdm_clk1_sleep = "/pinctrl/pdm/pdm-clk1-sleep";
    pdm_sdi0m0_sleep = "/pinctrl/pdm/pdm-sdi0m0-sleep";
    pdm_sdi0m1_sleep = "/pinctrl/pdm/pdm-sdi0m1-sleep";
    pdm_sdi1_sleep = "/pinctrl/pdm/pdm-sdi1-sleep";
    pdm_sdi2_sleep = "/pinctrl/pdm/pdm-sdi2-sleep";
    pdm_sdi3_sleep = "/pinctrl/pdm/pdm-sdi3-sleep";
    i2s0_8ch_mclk = "/pinctrl/i2s0/i2s0-8ch-mclk";
    i2s0_8ch_sclktx = "/pinctrl/i2s0/i2s0-8ch-sclktx";
    i2s0_8ch_sclkrx = "/pinctrl/i2s0/i2s0-8ch-sclkrx";
    i2s0_8ch_lrcktx = "/pinctrl/i2s0/i2s0-8ch-lrcktx";
    i2s0_8ch_lrckrx = "/pinctrl/i2s0/i2s0-8ch-lrckrx";
    i2s0_8ch_sdo0 = "/pinctrl/i2s0/i2s0-8ch-sdo0";
    i2s0_8ch_sdo1 = "/pinctrl/i2s0/i2s0-8ch-sdo1";
    i2s0_8ch_sdo2 = "/pinctrl/i2s0/i2s0-8ch-sdo2";
    i2s0_8ch_sdo3 = "/pinctrl/i2s0/i2s0-8ch-sdo3";
    i2s0_8ch_sdi0 = "/pinctrl/i2s0/i2s0-8ch-sdi0";
    i2s0_8ch_sdi1 = "/pinctrl/i2s0/i2s0-8ch-sdi1";
    i2s0_8ch_sdi2 = "/pinctrl/i2s0/i2s0-8ch-sdi2";
    i2s0_8ch_sdi3 = "/pinctrl/i2s0/i2s0-8ch-sdi3";
    i2s1_2ch_mclk = "/pinctrl/i2s1/i2s1-2ch-mclk";
    i2s1_2ch_sclk = "/pinctrl/i2s1/i2s1-2ch-sclk";
    i2s1_2ch_lrck = "/pinctrl/i2s1/i2s1-2ch-lrck";
    i2s1_2ch_sdi = "/pinctrl/i2s1/i2s1-2ch-sdi";
    i2s1_2ch_sdo = "/pinctrl/i2s1/i2s1-2ch-sdo";
    i2s2_2ch_mclk = "/pinctrl/i2s2/i2s2-2ch-mclk";
    i2s2_2ch_sclk = "/pinctrl/i2s2/i2s2-2ch-sclk";
    i2s2_2ch_lrck = "/pinctrl/i2s2/i2s2-2ch-lrck";
    i2s2_2ch_sdi = "/pinctrl/i2s2/i2s2-2ch-sdi";
    i2s2_2ch_sdo = "/pinctrl/i2s2/i2s2-2ch-sdo";
    sdmmc_clk = "/pinctrl/sdmmc/sdmmc-clk";
    sdmmc_cmd = "/pinctrl/sdmmc/sdmmc-cmd";
    sdmmc_det = "/pinctrl/sdmmc/sdmmc-det";
    sdmmc_bus1 = "/pinctrl/sdmmc/sdmmc-bus1";
    sdmmc_bus4 = "/pinctrl/sdmmc/sdmmc-bus4";
    sdmmc_gpio = "/pinctrl/sdmmc/sdmmc-gpio";
    sdio_clk = "/pinctrl/sdio/sdio-clk";
    sdio_cmd = "/pinctrl/sdio/sdio-cmd";
    sdio_bus4 = "/pinctrl/sdio/sdio-bus4";
    sdio_gpio = "/pinctrl/sdio/sdio-gpio";
    emmc_clk = "/pinctrl/emmc/emmc-clk";
    emmc_cmd = "/pinctrl/emmc/emmc-cmd";
    emmc_pwren = "/pinctrl/emmc/emmc-pwren";
    emmc_rstnout = "/pinctrl/emmc/emmc-rstnout";
    emmc_bus1 = "/pinctrl/emmc/emmc-bus1";
    emmc_bus4 = "/pinctrl/emmc/emmc-bus4";
    emmc_bus8 = "/pinctrl/emmc/emmc-bus8";
    flash_cs0 = "/pinctrl/flash/flash-cs0";
    flash_rdy = "/pinctrl/flash/flash-rdy";
    flash_dqs = "/pinctrl/flash/flash-dqs";
    flash_ale = "/pinctrl/flash/flash-ale";
    flash_cle = "/pinctrl/flash/flash-cle";
    flash_wrn = "/pinctrl/flash/flash-wrn";
    flash_csl = "/pinctrl/flash/flash-csl";
    flash_rdn = "/pinctrl/flash/flash-rdn";
    flash_bus8 = "/pinctrl/flash/flash-bus8";
    lcdc_m0_rgb_pins = "/pinctrl/lcdc/lcdc-m0-rgb-pins";
    lcdc_m0_sleep_pins = "/pinctrl/lcdc/lcdc-m0-sleep-pins";
    lcdc_m1_rgb_pins = "/pinctrl/lcdc/lcdc-m1-rgb-pins";
    lcdc_m1_sleep_pins = "/pinctrl/lcdc/lcdc-m1-sleep-pins";
    pwm0_pin = "/pinctrl/pwm0/pwm0-pin";
    pwm1_pin = "/pinctrl/pwm1/pwm1-pin";
    pwm2_pin = "/pinctrl/pwm2/pwm2-pin";
    pwm3_pin = "/pinctrl/pwm3/pwm3-pin";
    pwm4_pin = "/pinctrl/pwm4/pwm4-pin";
    pwm5_pin = "/pinctrl/pwm5/pwm5-pin";
    pwm6_pin = "/pinctrl/pwm6/pwm6-pin";
    pwm7_pin = "/pinctrl/pwm7/pwm7-pin";
    rmii_pins = "/pinctrl/gmac/rmii-pins";
    mac_refclk_12ma = "/pinctrl/gmac/mac-refclk-12ma";
    mac_refclk = "/pinctrl/gmac/mac-refclk";
    cif_clkout_m0 = "/pinctrl/cif-m0/cif-clkout-m0";
    dvp_d2d9_m0 = "/pinctrl/cif-m0/dvp-d2d9-m0";
    dvp_d0d1_m0 = "/pinctrl/cif-m0/dvp-d0d1-m0";
    dvp_d10d11_m0 = "/pinctrl/cif-m0/d10-d11-m0";
    cif_clkout_m1 = "/pinctrl/cif-m1/cif-clkout-m1";
    dvp_d2d9_m1 = "/pinctrl/cif-m1/dvp-d2d9-m1";
    dvp_d0d1_m1 = "/pinctrl/cif-m1/dvp-d0d1-m1";
    dvp_d10d11_m1 = "/pinctrl/cif-m1/d10-d11-m1";
    isp_prelight = "/pinctrl/isp/isp-prelight";
    pmic_int = "/pinctrl/pmic/pmic_int";
    soc_slppin_gpio = "/pinctrl/pmic/soc_slppin_gpio";
    soc_slppin_slp = "/pinctrl/pmic/soc_slppin_slp";
    soc_slppin_rst = "/pinctrl/pmic/soc_slppin_rst";
    vcc18_lcd_n = "/pinctrl/vcc18-lcd/vcc18-lcd-n";
    vcc5_usb = "/pinctrl/vcc5-usb/vcc5-usb";
    btn_pins = "/pinctrl/btns/btn-pins";
    hp_det = "/pinctrl/headphone/hp-det";
    drm_logo = "/reserved-memory/drm-logo@00000000";
    ramoops_mem = "/reserved-memory/region@110000";
    vol_keys = "/rg351-keys";
    joypad = "/odroidgo3-joypad";
    backlight = "/backlight";
    vccsys = "/vccsys";
    wireless_wlan = "/wireless-wlan";
    vcc18_lcd0 = "/vcc18_lcd0";
    vcc_host = "/vcc_host";
};
